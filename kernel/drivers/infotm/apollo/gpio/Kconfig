## kernel/drivers/infotm/apollo/gpio/Kconfig
```kconfig
#
# GPIO system
#
#

menuconfig INFOTM_GPIO_CHIP
  bool "Infotm gpio chip driver support"
  help
    Infotm gpio chip driver support

if INFOTM_GPIO_CHIP

config APOLLO_GPIO_CHIP
 bool "apollo gpio chip driver support"
 help
   apollo gpio chip driver support

endif
```

## kernel/drivers/infotm/apollo/input/Kconfig
```kconfig
 #                                                 
 #  Input device configuration                     
 #                                                 
 #                                                 
menuconfig APOLLO_INPUT                            
        bool "apollo input device driver support"  
        default n                                  
        help                                       
               Infotm input device driver support   
if APOLLO_INPUT                                    
source "drivers/infotm/apollo/input/keyboard/Kconfig"     
endif                                              
```

## kernel/drivers/infotm/apollo/input/keyboard/Kconfig
```kconfig
menuconfig APOLLO_KEYBOARD
	bool "apollo Keyboards and keypads"
if APOLLO_KEYBOARD
	config APOLLO_GPIO_KEYS
	tristate "apollo GPIO Keys"
	default n
	help
	  Say Y here if you want to use the GPIO keys of apollo.

	config APOLLO_POWER_KEY
	tristate "apollo power Key"
	default n
	help
	  Say Y here if you want to use the power key of apollo.
endif
```

## kernel/drivers/infotm/apollo/ispost/Kconfig
```kconfig
 #
 #  Ispost device configuration
 #
 #
config INFOTM_ISPOST
        tristate "Infotm Ispost"
        default y
        help
               Infotm ispost device driver support
```

## kernel/drivers/infotm/apollo/mfd/Kconfig
```kconfig
menuconfig INFOTM_MFD
  bool "Infotm mfd driver support"
  help
    Infotm multi func device driver support

if INFOTM_MFD

config APOLLO_MFD
 bool "apollo mfd driver support"
 help
   apollo multi func device driver support

config PMIC_DEBUG_IF
 bool "PMIC register debug interface"
 depends on INFOTM_MFD
 default n
 help
   debug function for PMICs 

endif
```

## kernel/drivers/infotm/apollo/power_domain/Kconfig
```kconfig
config APOLLO_PD_DEBUG
  bool "Apollo PowerDomain debug support"
  default n
  help
    Apollo Power Domain debug support
```

## kernel/drivers/infotm/apollo/regulator/Kconfig
```kconfig
menuconfig INFOTM_REGULATOR
  bool "Infotm regulator driver support"
  help
    Infotm regulator driver support

if INFOTM_REGULATOR

config APOLLO_REGULATOR
 bool "apollo regulator driver support"
 help
   apollo regulator driver support

endif
```

## kernel/drivers/infotm/apollo3/Kconfig
```kconfig
 menuconfig INFOTM_DRV_APOLLO3
     bool "Infotm APOLLO3 Series Support"
     depends on ARCH_APOLLO3 && INFOTM_SPECIAL
     help
         Infotm APOLLO3 Series support

if INFOTM_DRV_APOLLO3
source "drivers/infotm/apollo3/clk/Kconfig"
source "drivers/infotm/apollo3/gpio/Kconfig"
source "drivers/infotm/apollo3/input/Kconfig"
source "drivers/infotm/apollo3/display/Kconfig"
source "drivers/infotm/apollo3/dpmu/Kconfig"
source "drivers/infotm/apollo3/emif/Kconfig"
source "drivers/infotm/apollo3/mfd/Kconfig"
source "drivers/infotm/apollo3/regulator/Kconfig"
source "drivers/infotm/apollo3/ispost/Kconfig"
source "drivers/infotm/apollo3/power_domain/Kconfig"
endif
```

## kernel/drivers/infotm/apollo3/clk/Kconfig
```kconfig
 #                                                 
 #  Clock device configuration                     
 #                                                 
 #                                                 
menuconfig APOLLO3_CLK                           
        bool "APOLLO3 clock driver support"
		depends on COMMON_CLK
        default n                                  
        help                                       
               Infotm input device driver suport   
```

## kernel/drivers/infotm/apollo3/gpio/Kconfig
```kconfig
#
# GPIO system
#
#

menuconfig INFOTM_GPIO_CHIP
  bool "Infotm gpio chip driver support"
  help
    Infotm gpio chip driver support

if INFOTM_GPIO_CHIP

config APOLLO3_GPIO_CHIP
 bool "APOLLO3 gpio chip driver support"
 help
   apollo3 gpio chip driver support

endif
```

## kernel/drivers/infotm/apollo3/input/Kconfig
```kconfig
 #                                                 
 #  Input device configuration                     
 #                                                 
 #                                                 
menuconfig APOLLO3_INPUT                            
        bool "APOLLO3 input device driver support"  
        default n                                  
        help                                       
               Infotm input device driver support   
if APOLLO3_INPUT                                    
source "drivers/infotm/apollo3/input/keyboard/Kconfig"     
endif                                              
```

## kernel/drivers/infotm/apollo3/input/keyboard/Kconfig
```kconfig
menuconfig APOLLO3_KEYBOARD
	bool "apollo3 Keyboards and keypads"
if APOLLO3_KEYBOARD
	config APOLLO3_GPIO_KEYS
	tristate "apollo3 GPIO Keys"
	default n
	help
	  Say Y here if you want to use the GPIO keys of apollo3.

	config APOLLO3_POWER_KEY_IP6313
	tristate "apollo3 ip6313 power Key"
	default n
	help
	  Say Y here if you want to use the IP6313 power key of apollo3.

	config APOLLO3_POWER_KEY_FPGA
	depends on APOLLO3_FPGA_PLATFORM 
	tristate "apollo3 fpga power Key"
	default n
	help
	  Say Y here if you want to use the IP6203 power key of apollo3.

	config APOLLO3_POWER_KEY_IP6303
	tristate "apollo3 ip6303 power Key"
	default n
	help
	  Say Y here if you want to use the IP6303 power key of apollo3.
endif
```

## kernel/drivers/infotm/apollo3/ispost/Kconfig
```kconfig
 #
 #  Ispost device configuration
 #
 #
config INFOTM_ISPOST
        tristate "Infotm Ispost driver"
        default y
        help
               Infotm ispost device driver support
```

## kernel/drivers/infotm/apollo3/mfd/Kconfig
```kconfig
menuconfig INFOTM_MFD
  bool "Infotm mfd driver support"
  help
    Infotm multi func device driver support

if INFOTM_MFD

config APOLLO3_MFD_IP6313
 bool "IP6313 driver support"
 help
   IP6313 used

config APOLLO3_MFD_IP6303
 bool "IP6303 driver support"
 help
   IP6303 supported

config PMIC_DEBUG_IF
 bool "PMIC register debug interface"
 depends on INFOTM_MFD
 default n
 help
   debug function for PMICs 
endif
```

## kernel/drivers/infotm/apollo3/power_domain/Kconfig
```kconfig
config APOLLO3_PD_DEBUG
  bool "Apollo3 PowerDomain debug support"
  default n
  help
    Apollo3 Power Domain debug support
```

## kernel/drivers/infotm/apollo3/regulator/Kconfig
```kconfig
menuconfig INFOTM_REGULATOR
  bool "Infotm regulator driver support"
  help
    Infotm regulator driver support

if INFOTM_REGULATOR

config APOLLO3_REGULATOR_IP6313
 bool "ip6313 regulator driver"
 help
   IP6313 regulator driver

config APOLLO3_REGULATOR_IP6303
 bool "ip6303 regulator driver"
 help
   IP6303 regulator driver

endif
```

## kernel/drivers/infotm/common/InfotmMedia/Kconfig
```kconfig
#
# Multimedia device configuration
#

menuconfig INFOTM_MEDIA_SUPPORT
	bool "Infotm Media driver support"
	default y
	help
		InfotmMedia driver support

if INFOTM_MEDIA_SUPPORT

# dmmu_drv
source "drivers/infotm/common/InfotmMedia/external/project/dmmu_drv/Kconfig"

# vdec_drv_g1
source "drivers/infotm/common/InfotmMedia/external/project/vdec_drv_g1/Kconfig"

# venc_drv_8270
source "drivers/infotm/common/InfotmMedia/external/project/venc_drv_8270/Kconfig"
source "drivers/infotm/common/InfotmMedia/external/project/fpga_venc_264_h1/Kconfig"
source "drivers/infotm/common/InfotmMedia/external/project/fpga_vdec_264_g1/Kconfig"
source "drivers/infotm/common/InfotmMedia/external/project/fpga_venc_265_h2/Kconfig"
source "drivers/infotm/common/InfotmMedia/external/project/fpga_vdec_265_g2/Kconfig"
source "drivers/infotm/common/InfotmMedia/external/project/jenc/Kconfig"
source "drivers/infotm/common/InfotmMedia/external/project/venc_h265_v4/Kconfig"

endif # INFOTM_MEDIA_SUPPORT
```

## kernel/drivers/infotm/common/InfotmMedia/external/project/dmmu_drv/Kconfig
```kconfig
#
# Kconfig InfotmMedia dmmu driver.
#
# Copyright (c) 2009~2014 ShangHai Infotm Ltd all rights reserved.
#
#

config INFOTM_MEDIA_DMMU_SUPPORT
	bool "InfotmMedia dmmu driver support"
    depends on INFOTM_MEDIA_SUPPORT
	default y
```

## kernel/drivers/infotm/common/InfotmMedia/external/project/fpga_vdec_264_g1/Kconfig
```kconfig
#
# Kconfig InfotmMedia vdec G1 driver.
#
# Copyright (c) 2009~2014 ShangHai Infotm Ltd all rights reserved.
#
#

menuconfig INFOTM_MEDIA_VDEC_G1_SUPPORT
        bool "InfotmMedia vdec g1 driver support"
        default n

if INFOTM_MEDIA_VDEC_G1_SUPPORT

config VDEC_POLL_MODE
	#tristate "vdec poll mode"
	bool "use poll system call to inform decode lib a frame finished"
	depends on INFOTM_MEDIA_VDEC_G1_SUPPORT 
	default y

config VDEC_DVFS_SUPPORT
	bool "vdec DVFS support"
	depends on INFOTM_MEDIA_VDEC_G1_SUPPORT
	default y

endif   #INFOTM_MEDIA_VDEC_G1_SUPPORT
```

## kernel/drivers/infotm/common/InfotmMedia/external/project/fpga_vdec_265_g2/Kconfig
```kconfig
#
# Kconfig InfotmMedia venc 8270 driver.
#
# Copyright (c) 2009~2014 ShangHai Infotm Ltd all rights reserved.
#
#

menuconfig INFOTM_MEDIA_VDEC_G2_SUPPORT
        bool "InfotmMedia vdec g2 driver support"
        default n
		select INFOTM_MEDIA_VDEC_G1_SUPPORT
```

## kernel/drivers/infotm/common/InfotmMedia/external/project/fpga_venc_264_h1/Kconfig
```kconfig
#
# Kconfig InfotmMedia venc 8270 driver.
#
# Copyright (c) 2009~2014 ShangHai Infotm Ltd all rights reserved.
#
#

config INFOTM_MEDIA_VENC_H1_SUPPORT
        tristate "InfotmMedia venc h1 driver support"
        default n
        help
            InfotmMedia venc h1 driver support
```

## kernel/drivers/infotm/common/InfotmMedia/external/project/fpga_venc_265_h2/Kconfig
```kconfig
#
# Kconfig InfotmMedia venc 8270 driver.
#
# Copyright (c) 2009~2014 ShangHai Infotm Ltd all rights reserved.
#
#

config INFOTM_MEDIA_VENC_H2_SUPPORT
        tristate "InfotmMedia venc h2 driver support"
        default n
        help
            InfotmMedia venc h2 driver support
```

## kernel/drivers/infotm/common/InfotmMedia/external/project/jenc/Kconfig
```kconfig
#
# Kconfig InfotmMedia jenc apollo3 driver.
#
# Copyright (c) 2009~2014 ShangHai Infotm Ltd all rights reserved.
#
#

config INFOTM_MEDIA_JENC_SUPPORT
        tristate "InfotmMedia jenc driver support"
        default n
        help
                InfotmMedia jpeg encoder support
```

## kernel/drivers/infotm/common/InfotmMedia/external/project/vdec_drv_g1/Kconfig
```kconfig
#
# Kconfig InfotmMedia vdec G1 driver.
#
# Copyright (c) 2009~2014 ShangHai Infotm Ltd all rights reserved.
#
#

menuconfig INFOTM_MEDIA_VDEC_G1V0_SUPPORT
        bool "InfotmMedia vdec G1 driver support(OLD)"
        default n
        ---help---
        	vdec-G1 driver

if INFOTM_MEDIA_VDEC_G1V0_SUPPORT

config VDEC_POLL_MODE
	bool "use poll system call to inform decode lib a frame finished"
	depends on INFOTM_MEDIA_VDEC_G1V0_SUPPORT 
	default y

config VDEC_DVFS_SUPPORT
	bool "vdec DVFS support"
	depends on INFOTM_MEDIA_VDEC_G1V0_SUPPORT
	default n

endif   #INFOTM_MEDIA_VDEC_G1V0_SUPPORT
```
