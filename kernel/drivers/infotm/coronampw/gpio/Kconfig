## kernel/drivers/infotm/coronampw/gpio/Kconfig
```kconfig
#
# GPIO system
#
#

menuconfig INFOTM_GPIO_CHIP
  bool "Infotm gpio chip driver support"
  help
    Infotm gpio chip driver support

if INFOTM_GPIO_CHIP

config CORONAMPW_GPIO_CHIP
 bool "CORONAMPW gpio chip driver support"
 help
   coronampw gpio chip driver support

endif
```

## kernel/drivers/infotm/coronampw/input/Kconfig
```kconfig
 #                                                 
 #  Input device configuration                     
 #                                                 
 #                                                 
menuconfig CORONAMPW_INPUT                            
        bool "CORONAMPW input device driver support"  
        default n                                  
        help                                       
               Infotm input device driver support   
if CORONAMPW_INPUT                                    
source "drivers/infotm/coronampw/input/keyboard/Kconfig"     
endif                                              
```

## kernel/drivers/infotm/coronampw/input/keyboard/Kconfig
```kconfig
menuconfig CORONAMPW_KEYBOARD
	bool "coronampw Keyboards and keypads"
if CORONAMPW_KEYBOARD
	config CORONAMPW_GPIO_KEYS
	tristate "coronampw GPIO Keys"
	default n
	help
	  Say Y here if you want to use the GPIO keys of coronampw.

	config CORONAMPW_POWER_KEY_IP6313
	tristate "coronampw ip6313 power Key"
	default n
	help
	  Say Y here if you want to use the IP6313 power key of coronampw.

	config CORONAMPW_POWER_KEY_FPGA
	depends on CORONAMPW_FPGA_PLATFORM 
	tristate "coronampw fpga power Key"
	default n
	help
	  Say Y here if you want to use the IP6203 power key of coronampw.
endif
```

## kernel/drivers/infotm/coronampw/mfd/Kconfig
```kconfig
menuconfig INFOTM_MFD
  bool "Infotm mfd driver support"
  help
    Infotm multi func device driver support

if INFOTM_MFD

config CORONAMPW_MFD_IP6313
 bool "IP6313 driver support"
 help
   IP6313 used
endif
```

## kernel/drivers/infotm/coronampw/regulator/Kconfig
```kconfig
menuconfig INFOTM_REGULATOR
  bool "Infotm regulator driver support"
  help
    Infotm regulator driver support

if INFOTM_REGULATOR

config CORONAMPW_REGULATOR_IP6313
 bool "ip6313 regulator driver"
 help
   IP6313 regulator driver
endif
```

## kernel/drivers/infotm/imapx15/Kconfig
```kconfig
 menuconfig INFOTM_DRV_IMAPX15                          
     bool "Infotm iMAPx15 Series Support"           
     depends on ARCH_IMAPX15 && INFOTM_SPECIAL      
     help                                            
         Infotm iMAPx15 Series support              
                                                     
 if INFOTM_DRV_IMAPX15                                  
source "drivers/infotm/imapx15/clk/Kconfig"
source "drivers/infotm/imapx15/power/Kconfig"
source "drivers/infotm/imapx15/gpio/Kconfig"
source "drivers/infotm/imapx15/input/Kconfig"
source "drivers/infotm/imapx15/mtd/Kconfig"
source "drivers/infotm/imapx15/g2d/Kconfig"
source "drivers/infotm/imapx15/emif/Kconfig"
#source "drivers/infotm/imapx15/adc/Kconfig"
                                                     
 endif                                               
```

## kernel/drivers/infotm/imapx15/adc/Kconfig
```kconfig
#
# ADC configuration
#
menuconfig INFOTM_ADC
	bool "InfoTM adc driver support"
	default n
	help
		InfoTM adr driver support

if INFOTM_ADC
config IMAPX15_ADC
	bool "iMAPx15 adc driver support"
	default n
	help
		InfoTM iMAPx15 adc driver support
endif
```

## kernel/drivers/infotm/imapx15/clk/Kconfig
```kconfig
 #                                                 
 #  Clock device configuration                     
 #                                                 
 #                                                 
menuconfig IMAPX15_CLK                           
        bool "imapx15 clock driver support"
		depends on COMMON_CLK
        default n                                  
        help                                       
               Infotm input device driver suport   
```

## kernel/drivers/infotm/imapx15/g2d/Kconfig
```kconfig
menuconfig INFOTM_G2D
  bool "Infotm g2d driver support"
  help                             
    Infotm g2d driver support     
                                   
if INFOTM_G2D
                                   
config IMAPX15_G2D
 bool "iMAPx15 g2d driver support"
 help                              
   iMAPx15 g2d driver support     
                                   
endif                              
```

## kernel/drivers/infotm/imapx15/gpio/Kconfig
```kconfig
#
# GPIO system
#
#

menuconfig INFOTM_GPIO
  bool "Infotm gpio driver support"
  help
    Infotm gpio driver support

if INFOTM_GPIO

config GPIO_IMAPX15
 bool "iMAPx15 gpio driver support"
 help
   iMAPx15 gpio driver support

endif
```

## kernel/drivers/infotm/imapx15/input/Kconfig
```kconfig
 #                                                 
 #  Input device configuration                     
 #                                                 
 #                                                 
menuconfig IMAPX15_INPUT                            
        bool "imapx15 input device driver support"  
        default y                                  
        help                                       
               Infotm input device driver suport   
if IMAPX15_INPUT                                    
                                                   
source "drivers/infotm/imapx15/input/keyboard/Kconfig"     
                                                   
endif                                              
```

## kernel/drivers/infotm/imapx15/input/keyboard/Kconfig
```kconfig
menuconfig IMAPX15_KEYBOARD
	bool "iMAPx15 Keyboards and keypads"
if IMAPX15_KEYBOARD
	config IMAPX15_GPIO_KEY
	tristate "iMAPX15 GPIO Keys"                             
	default y                                                 
	help                                                      
	Say Y here if you want to use the GPIO keys of iMAPx15.
endif
```

## kernel/drivers/infotm/imapx15/mtd/Kconfig
```kconfig
#
# Infotm NAND device configuration
#

menu "Infotm NAND Flash support"

config INFOTM_NAND
	bool "Infotm NAND FLASH imapx800 SUPPORT"
	default y
        select MTD_NAND 
        select MTD_BLOCK
        help
		This is new nand suport

config MTD_INFOTM_NAND
	bool "InfoTMIC separate NAND system support"
	depends on MTD
	help
	  This enables support for accessing all type of NAND flash
	  devices. For further information see
	  <http://www.linux-mtd.infradead.org/doc/nand.html>.

choice
	prompt "NAND transfer method"
	depends on MTD_INFOTM_NAND

config MTD_NAND_IMAPX800_POLL
    comment "CPU polling"
	depends on MTD_INFOTM_NAND

config MTD_NAND_IMAPX800_SDMA
    comment "Simple DMA transfer"
	depends on MTD_INFOTM_NAND
endchoice	

config MTD_NAND_IMAPX800_SECC
    bool "use secc mode"
    depends on MTD

endmenu
```

## kernel/drivers/infotm/imapx15/power/Kconfig
```kconfig
menuconfig INFOTM_POWER
        bool "Infotm Power support"
        default y
        help
        Say Y here if you want to use the Infotm power management.

if INFOTM_POWER

source "drivers/infotm/imapx15/power/axp_power/Kconfig"
source "drivers/infotm/imapx15/power/mfd/Kconfig"
source "drivers/infotm/imapx15/power/regulator/Kconfig"
source "drivers/infotm/imapx15/power/battery/Kconfig"

endif
```

## kernel/drivers/infotm/imapx15/power/battery/Kconfig
```kconfig
config IMAPX820_BATTERY_COMM
        tristate "iMAPx820 battery driver comm"
        help
         Say Y to include support for iMAPx820 battery comm.


config IMAPX820_BATTERY_S
        tristate "iMAPx820 simple battery driver"
        help
         Say Y to include support for iMAPx820 battery simple.

config IMAPX820_BATTERY
        tristate "iMAPx820 battery driver"
        help
         Say Y to include support for iMAPx820 battery.
```

## kernel/drivers/infotm/imapx15/power/mfd/Kconfig
```kconfig
config IMAP_TPS65910
        tristate "tps65910"
	select MFD_CORE
        help
         tps65910 driver 
```

## kernel/drivers/infotm/imapx15/power/regulator/Kconfig
```kconfig
config IMAP_REGULATOR_TPS65910
        tristate "tps65910-REGULATOR"
        help
         tps65910 regulator driver 
```

## kernel/drivers/infotm/imapx910/Kconfig
```kconfig
menuconfig INFOTM_DRV_IMAPX910
	bool "Infotm iMAPx910 drivers support"
	depends on ARCH_IMAPX910 && INFOTM_SPECIAL
	help
		Infotm iMAPx910 drivers support

if INFOTM_DRV_IMAPX910
	
source "drivers/infotm/imapx910/mfd/Kconfig"
source "drivers/infotm/imapx910/regulator/Kconfig"
source "drivers/infotm/imapx910/power/Kconfig"
source "drivers/infotm/imapx910/input/Kconfig"
source "drivers/infotm/imapx910/clk/Kconfig"
source "drivers/infotm/imapx910/gpio/Kconfig"
source "drivers/infotm/imapx910/mtd/Kconfig"
source "drivers/infotm/imapx910/hwmon/Kconfig"

endif
```

## kernel/drivers/infotm/imapx910/clk/Kconfig
```kconfig
 #                                                 
 #  Clock device configuration                     
 #                                                 
 #                                                 
menuconfig IMAPX910_CLK                           
        bool "imapx910 clock driver support"
		depends on COMMON_CLK
        default n                                  
        help                                       
               Infotm input device driver suport   
```

## kernel/drivers/infotm/imapx910/gpio/Kconfig
```kconfig
#
# GPIO system
#
#

menuconfig INFOTM_GPIO
  bool "Infotm gpio driver support"
  help
    Infotm gpio driver support

if INFOTM_GPIO

config GPIO_IMAPX910
 bool "iMAPx910 gpio driver support"
 help
   iMAPx910 gpio driver support

endif
```

## kernel/drivers/infotm/imapx910/hwmon/Kconfig
```kconfig
menuconfig IMAPX910_HWMON
	bool "Imapx9 hardware monitor support"
	default y
	select HWMON
	help 
	This is for imapx9 hardware monitor sensors
if IMAPX910_HWMON
config IMAPX910_TEMP
	tristate "iMAPx9 cpu/gpu temp sensor driver"
	default y
	help
	 keep this disselected while not sure
endif
```

## kernel/drivers/infotm/imapx910/input/Kconfig
```kconfig
 #                                                 
 #  Input device configuration                     
 #                                                 
 #                                                 
menuconfig IMAPX910_INPUT                            
        bool "imapx910 input device driver support"  
        default y                                  
        help                                       
               Infotm input device driver suport   
if IMAPX910_INPUT                                    
                                                   
source "drivers/infotm/imapx910/input/keyboard/Kconfig"     
                                                   
endif                                              
```

## kernel/drivers/infotm/imapx910/input/keyboard/Kconfig
```kconfig
menuconfig IMAPX910_KEYBOARD
	bool "iMAPx910 Keyboards and keypads"
if IMAPX910_KEYBOARD
	config IMAPX910_GPIO_KEY
	tristate "iMAPX910 GPIO Keys"                             
	default y                                                 
	help                                                      
	Say Y here if you want to use the GPIO keys of iMAPx910.

config IMAPX910_PWRKEY_RICOH618
	tristate "Power Key Ricoh R5T618 input driver support"
	help
	  Say Y here if you want to enable the power key ricoh
	  driver accessible at /dev/ricoh618-pwrkey. This driver
	  can be used for receiving notifications when client
	  power key combinations are pressed.To compile this
	  driver as a module, choose M here: the module will
	  be called keychord.
endif
```

## kernel/drivers/infotm/imapx910/mfd/Kconfig
```kconfig
menuconfig INFOTM_MFD
  bool "iMAPx910 mfd drivers support"
  help
    iMAPx910 mfd drivers support

if INFOTM_MFD

config MFD_RICOH618
  bool "Ricoh R5T618 Power Management system device"
  depends on I2C && GPIOLIB && GENERIC_HARDIRQS
  select MFD_CORE
  default n
    help
    If you say yes here you get support for the Ricoh R5T618
    Power Management system device.
    This driver provides common support for accessing the device,
    additional drivers must be enabled in order to use the
    functionality of the device.

config MFD_MP8845C
  bool "mp8845c chip"
  depends on I2C && GPIOLIB && GENERIC_HARDIRQS
  select MFD_CORE
  default n
  help
    mp8845c chip.

endif
```

## kernel/drivers/infotm/imapx910/mtd/Kconfig
```kconfig
#
# Infotm NAND device configuration
#
menuconfig INFOTM_MTD
	        bool "InfoTMIC separate MTD support"                          
        depends on MTD                                                
        help                                                          
          This enables support for accessing all type of NAND flash   
          devices. For further information see                        
          <http://www.linux-mtd.infradead.org/doc/nand.html>          
                                                                      
if INFOTM_MTD                                                         


config INFOTM_NAND
	bool "Infotm NAND FLASH imapx800 SUPPORT"
	depends on INFOTM_MTD
	default y
        select MTD_NAND 
        select MTD_BLOCK
        help
		This is new nand suport

config INFOTM_MTD_NAND
	bool "InfoTMIC separate NAND system support"
	depends on INFOTM_MTD
	help
	  This enables support for accessing all type of NAND flash
	  devices. For further information see
	  <http://www.linux-mtd.infradead.org/doc/nand.html>.

choice
	prompt "NAND transfer method"
	depends on INFOTM_MTD_NAND

config MTD_NAND_IMAPX800_POLL
    bool "CPU polling"
	depends on INFOTM_MTD_NAND

config MTD_NAND_IMAPX800_SDMA
    bool "Simple DMA transfer"
	depends on INFOTM_MTD_NAND
endchoice	

config MTD_NAND_IMAPX800_SECC
    bool "use secc mode"
    depends on MTD

endif
```
