## kernel/drivers/infotm/imapx910/power/Kconfig
```kconfig
menuconfig INFOTM_POWER
  bool "iMAPx910 battery drivers support"
  help
    iMAPx910 battery drivers support

if INFOTM_POWER

config BATTERY_RICOH618
  tristate "Ricoh R5T618 PMIC battery driver"
  depends on MFD_RICOH618 && I2C && GENERIC_HARDIRQS
    help
    Say Y to enable support for the battery control of the Ricoh R5T618
    Power Management device.

endif
```

## kernel/drivers/infotm/imapx910/regulator/Kconfig
```kconfig
menuconfig INFOTM_REGULATOR
  bool "iMAPx910 regulator drivers support"
  help
    iMAPx910 regulator drivers support

if INFOTM_REGULATOR

config REGULATOR_RICOH618
  tristate "Ricoh R5T618 Power regulators"
  depends on MFD_RICOH618
  default n
  help
    This driver supports regulator driver for the Ricoh R5T618
    Power Management device.

config REGULATOR_MP8845C
  bool "mp8845c regulator"
  depends on MFD_MP8845C
  default n
  help
    mp8845c regulator.

endif
```

## kernel/drivers/infotm/q3f/Kconfig
```kconfig
 menuconfig INFOTM_DRV_Q3F
     bool "Infotm Q3F Series Support"
     depends on ARCH_Q3F && INFOTM_SPECIAL
     help
         Infotm Q3F Series support

if INFOTM_DRV_Q3F
source "drivers/infotm/q3f/clk/Kconfig"
source "drivers/infotm/q3f/gpio/Kconfig"
source "drivers/infotm/q3f/input/Kconfig"
source "drivers/infotm/q3f/display/Kconfig"
source "drivers/infotm/q3f/dpmu/Kconfig"
source "drivers/infotm/q3f/emif/Kconfig"
source "drivers/infotm/q3f/mfd/Kconfig"
source "drivers/infotm/q3f/regulator/Kconfig"
source "drivers/infotm/q3f/char/Kconfig"
source "drivers/infotm/q3f/ispost/Kconfig"
source "drivers/infotm/q3f/fodet/Kconfig"
source "drivers/infotm/q3f/power_domain/Kconfig"
endif
```

## kernel/drivers/infotm/q3f/char/Kconfig
```kconfig
menuconfig Q3F_DSP
	bool "Q3F dsp driver support"
	default n
	help
		Infotm dsp driver support

if Q3F_DSP
source drivers/infotm/q3f/char/dsp/Kconfig
endif
```

## kernel/drivers/infotm/q3f/char/dsp/Kconfig
```kconfig
menuconfig Q3F_DSP_CEVA_TL421
	tristate "ceva tl421 dsp"
	default n
	help
	  Say Y here if dsp is ceva tl421.

if Q3F_DSP_CEVA_TL421

config Q3F_DSP_SUPPORT_ENCODE
	bool "Q3F dsp support Encode function"
	default n
	help
	  Say Y here if encode function is needed.

config Q3F_DSP_SUPPORT_DECODE
	bool "Q3F dsp support Decode function"
	default n
	help
	  Say Y here if decode function is needed.

config Q3F_DSP_SUPPORT_AEC
	bool "Q3F dsp support AEC function"
	default n
	help
	  Say Y here if AEC function is needed.

if Q3F_DSP_SUPPORT_AEC
choice 
    prompt "AEC Algorithm version choose"
    depends on Q3F_DSP_SUPPORT_AEC
    default SND_USE_AECV1
    help
         Select AEC Algorithm version on platform

    config SND_USE_AECV1
        bool "AEC Algorithm version 1"
        default n
        help
            Apply AEC Algorithm version1 on platform

    config SND_USE_AECV2
        bool "AEC Algorithm version 2"
        default n
        help
            Apply AEC Algorithm version2 on platform
endchoice
endif

endif
```

## kernel/drivers/infotm/q3f/clk/Kconfig
```kconfig
 #                                                 
 #  Clock device configuration                     
 #                                                 
 #                                                 
menuconfig Q3F_CLK                           
        bool "Q3F clock driver support"
		depends on COMMON_CLK
        default n                                  
        help                                       
               Infotm input device driver suport   
```

## kernel/drivers/infotm/q3f/display/Kconfig
```kconfig
menuconfig INFOTM_DISPLAY
	bool "Infotm display support"
	default y
	select FB_CFB_FILLRECT
	select FB_CFB_COPYAREA
	select FB_CFB_IMAGEBLIT
	select FB_SYS_FILLRECT
	select FB_SYS_COPYAREA
	select FB_SYS_IMAGEBLIT
	select FB_SYS_FOPS
	help
		This enables support for the Infotm display driver.

if INFOTM_DISPLAY

config DISPLAY_IMAPX
	bool "iMAPx display driver"
	default y
	help
		This enables support for the iMAPx series display driver.

choice Q3F_LCD_MODULE_SUPPORT
	bool "LCD module support in Q3F"
	default Q3F_LCD_SPI_ILI8961

	comment "must one lcd selected"

config Q3F_LCD_SPI_ILI8961
	tristate "ili8961 lcd driver support in Q3F"
	depends on LCD_SPI
	help
		This enables support ili8961 lcd driver in Q3F

config Q3F_LCD_SPI_OTA5182A
	tristate "ota5182a lcd driver support in Q3F"
	depends on LCD_SPI
	help
		This enables support ota5182a lcd driver in Q3F

config Q3F_CVBS_I2C_IP2906
	tristate "ip2906 lcd driver support in Q3F"
	depends on SND_SOC_IP2906
	help
		This enables support ip2906 cvbs driver in Q3F

endchoice
endif
```

## kernel/drivers/infotm/q3f/emif/Kconfig
```kconfig
menuconfig IMAP_EMIF_HW
    tristate "imapx800 emif"
	default n
	depends on ARCH_IMAPX800 || ARCH_IMAPX15
	help
	    for imapx800 emif driver


if IMAP_EMIF_HW

config INFOTM_EMIF
    tristate "Driver for imapx800 emif"
	help

endif
```

## kernel/drivers/infotm/q3f/fodet/Kconfig
```kconfig
 #
 #  Fodet device configuration
 #
 #
config INFOTM_FODET
        tristate "Infotm Fodet driver"
        default n
        help
               Infotm fodet device driver support
```

## kernel/drivers/infotm/q3f/gpio/Kconfig
```kconfig
#
# GPIO system
#
#

menuconfig INFOTM_GPIO_CHIP
  bool "Infotm gpio chip driver support"
  help
    Infotm gpio chip driver support

if INFOTM_GPIO_CHIP

config Q3F_GPIO_CHIP
 bool "Q3F gpio chip driver support"
 help
   q3f gpio chip driver support

endif
```

## kernel/drivers/infotm/q3f/input/Kconfig
```kconfig
 #                                                 
 #  Input device configuration                     
 #                                                 
 #                                                 
menuconfig Q3F_INPUT                            
        bool "Q3F input device driver support"  
        default n                                  
        help                                       
               Infotm input device driver support   
if Q3F_INPUT                                    
source "drivers/infotm/q3f/input/keyboard/Kconfig"     
endif                                              
```

## kernel/drivers/infotm/q3f/input/keyboard/Kconfig
```kconfig
menuconfig Q3F_KEYBOARD
	bool "q3f Keyboards and keypads"
if Q3F_KEYBOARD
	config Q3F_GPIO_KEYS
	tristate "q3f GPIO Keys"
	default n
	help
	  Say Y here if you want to use the GPIO keys of q3f.

	config Q3F_POWER_KEY_EC610
	tristate "q3f ec610 power Key"
	default n
	help
	  Say Y here if you want to use the EC610 power key of q3f.

	config Q3F_POWER_KEY_IP6205
	tristate "q3f ip6205 power Key"
	default n
	help
	  Say Y here if you want to use the IP6205 power key of q3f.

	config Q3F_POWER_KEY_IP6208
	tristate "q3f ip6208 power Key"
	default n
	help
	  Say Y here if you want to use the IP6208 power key of q3f.
	  
	config Q3F_POWER_KEY_IP6203
	tristate "q3f ip6203 power Key"
	default n
	help
	  Say Y here if you want to use the IP6203 power key of q3f.
	config Q3F_POWER_KEY_FPGA
	depends on Q3F_FPGA_PLATFORM 
	tristate "q3f fpga power Key"
	default n
	help
	  Say Y here if you want to use the IP6203 power key of q3f.
endif
```

## kernel/drivers/infotm/q3f/mfd/Kconfig
```kconfig
menuconfig INFOTM_MFD
  bool "Infotm mfd driver support"
  help
    Infotm multi func device driver support

if INFOTM_MFD

config Q3F_MFD_EC610
 bool "EC610 driver support"
 help
   EC610 used

config Q3F_MFD_IP6203
 bool "IP6203 driver support"
 help
   IP6203 used

config Q3F_MFD_IP620x
 bool "IP620x driver support"
 help
   IP620x used

config Q3F_MFD_IP6303
 bool "IP6303 driver support"
 help
   IP6303 used

config PMIC_DEBUG_IF
 bool "PMIC register debug interface"
 depends on INFOTM_MFD
 default n
 help
   debug function for PMICs 
endif
```

## kernel/drivers/infotm/q3f/power_domain/Kconfig
```kconfig
config APOLLO2_PD_DEBUG
  bool "Apollo2 PowerDomain debug support"
  default n
  help
    Apollo2 Power Domain debug support
```

## kernel/drivers/infotm/q3f/regulator/Kconfig
```kconfig
menuconfig INFOTM_REGULATOR
  bool "Infotm regulator driver support"
  help
    Infotm regulator driver support

if INFOTM_REGULATOR

config Q3F_REGULATOR_EC610
 bool "ec610 regulator driver"
 help
   EC610 regulator driver

config Q3F_REGULATOR_IP6203
 bool "ip6203 regulator driver"
 help
   IP6203 regulator driver

config Q3F_REGULATOR_IP620x
 bool "ip620x regulator driver"
 help
   IP620x regulator driver

config Q3F_REGULATOR_IP6303
 bool "ip6303 regulator driver"
 help
   IP6303 regulator driver
endif
```

## kernel/drivers/mtd/devices/mx35_spinand/Kconfig
```kconfig
config MTD_SPINAND_MX35
	tristate "SPINAND Device Support for Macronix"
	depends on MTD_NAND && SPI && !MTD_M25P80
	help
	  This enables support for accessing Macronix SPI NAND flash
	  devices. Becareful that SPI NAND cannot be used to m25p80
	  driver, so you may should disable the MTD m25p80 first.
	  If you have Macronix SPI NAND chip say yes.

	  If unsure, say no here.

config MTD_SPINAND_ONDIEECC
	bool "Use SPINAND internal ECC"
	depends on MTD_SPINAND_MT29F || MTD_SPINAND_MX35
	help
	  Internel ECC.
	  Enables Hardware ECC support for SPI NAND.

config MTD_SPINAND_QIO
	bool "Use Quad IO Read/Write Command"
	depends on MTD_SPINAND_MX35
	help
	  Quad IO Read/Write.
	  Enables Hardware Quad IO Read/Write support for Macronix
	  SPI NAND.
```

## kernel/drivers/net/wireless/bcmdhd6212/Kconfig
```kconfig
config BCMDHD_6212
	tristate "Broadcom 6212 FullMAC wireless cards support"
	---help---
	  This module adds support for wireless adapters based on
	  Broadcom FullMAC chipset.

config BCMDHD_FW_PATH
	depends on BCMDHD_6212
	string "Firmware path"
	default "/etc/firmware/fw_bcmdhd.bin"
	---help---
	  Path to the firmware file.

config BCMDHD_NVRAM_PATH
	depends on BCMDHD_6212
	string "NVRAM path"
	default "/etc/firmware/nvram.txt"
	---help---
	  Path to the calibration file.

config BCMDHD_CONFIG_PATH
	depends on BCMDHD_6212
	string "Config path"
	default "/etc/firmware/config.txt"
	---help---
	  Path to the driver configuration file.

config BCMDHD_WEXT
	bool "Enable WEXT support"
	depends on BCMDHD_6212 && CFG80211 = n
	select WIRELESS_EXT
	select WEXT_PRIV
	help
	  Enables WEXT support

choice
	depends on BCMDHD_6212
	prompt "Interrupt type"
	---help---
	  Interrupt type
config BCMDHD_SDIO_IRQ
	depends on BCMDHD_6212
	bool "In-Band Interrupt"
	---help---
	  Interrupt from SDIO DAT[1]
endchoice
```

## system/Config.in
```kconfig
menu  "Apps"
        source "$BR2_EXTERNAL/eventhub/Config.in"
        source "$BR2_EXTERNAL/cep/Config.in"
        source "$BR2_EXTERNAL/audiobox/Config.in"
        source "$BR2_EXTERNAL/audiobox2/Config.in"
        source "$BR2_EXTERNAL/abctrl2/Config.in"
        source "$BR2_EXTERNAL/videobox/Config.in"
        source "$BR2_EXTERNAL/bblite/Config.in"
        source "$BR2_EXTERNAL/app-d304-main/Config.in"
        source "$BR2_EXTERNAL/app-d304-upgrade/Config.in"
        source "$BR2_EXTERNAL/app-d304-bt/Config.in"
        source "$BR2_EXTERNAL/app-specs-bt/Config.in"
        source "$BR2_EXTERNAL/app-libra-main/Config.in"
        source "$BR2_EXTERNAL/app-libra-dana/Config.in"
        source "$BR2_EXTERNAL/app-d304-ft/Config.in"
        source "$BR2_EXTERNAL/app-launcher/Config.in"
        source "$BR2_EXTERNAL/app-boot-selector/Config.in"
        source "$BR2_EXTERNAL/app-ittd/Config.in"
        source "$BR2_EXTERNAL/fisheye_k_tool/Config.in"
        source "$BR2_EXTERNAL/app-vrec/Config.in"
				source "$BR2_EXTERNAL/qm/Config.in"
				source "$BR2_EXTERNAL/bfgminer/Config.in"
endmenu

menu  "Libs"
        source "$BR2_EXTERNAL/qlibupgrade/Config.in"
        source "$BR2_EXTERNAL/qlibwifi/Config.in"
        source "$BR2_EXTERNAL/qlibvplay/Config.in"
        source "$BR2_EXTERNAL/qlibsensors/Config.in"
        source "$BR2_EXTERNAL/qlibcrypto/Config.in"
		source "$BR2_EXTERNAL/qlibcertif/Config.in"
        source "$BR2_EXTERNAL/hlibispv2500/Config.in"
        source "$BR2_EXTERNAL/hlibispv2505/Config.in"
        source "$BR2_EXTERNAL/libcodecs/Config.in"
        source "$BR2_EXTERNAL/libdemux/Config.in"
        source "$BR2_EXTERNAL/hlibispostv1/Config.in"
        source "$BR2_EXTERNAL/hlibispostv2/Config.in"
        source "$BR2_EXTERNAL/libfreetype/Config.in"
        source "$BR2_EXTERNAL/hlibfodetv2/Config.in"
        source "$BR2_EXTERNAL/hlibfr/Config.in"
        source "$BR2_EXTERNAL/hlibguvc/Config.in"
        source "$BR2_EXTERNAL/librtsp/Config.in"
        source "$BR2_EXTERNAL/qlibmediautils/Config.in"
        source "$BR2_EXTERNAL/libgridtools/Config.in"
        source "$BR2_EXTERNAL/hlibdsp/Config.in"
        source "$BR2_EXTERNAL/hlibvcp7g/Config.in"
        source "$BR2_EXTERNAL/libh264bitstream/Config.in"
        source "$BR2_EXTERNAL/hlibjenc/Config.in"
        source "$BR2_EXTERNAL/libffmpeg/Config.in"
        source "$BR2_EXTERNAL/hlibcamsensor/Config.in"
        source "$BR2_EXTERNAL/hlibh1v6/Config.in"
        source "$BR2_EXTERNAL/hlibh2v1/Config.in"
        source "$BR2_EXTERNAL/hlibh2v4/Config.in"
        source "$BR2_EXTERNAL/qlibsmartrc/Config.in"
        source "$BR2_EXTERNAL/libminigui/Config.in"
		source "$BR2_EXTERNAL/hlibvideodebug/Config.in"
			source "$BR2_EXTERNAL/qm-hal/Config.in"
endmenu

menu  "Debug Tools"
        source "$BR2_EXTERNAL/iuw/Config.in"
        source "$BR2_EXTERNAL/testing/Config.in"
        source "$BR2_EXTERNAL/app-demos/Config.in"
endmenu
```

## system/abctrl2/Config.in
```kconfig
config BR2_PACKAGE_ABCTRL_2
	bool "Abctrl_2"
	default n
	help
	  Abctrl2 module is to verify Audiobox2 functionality
```

## system/app-boot-selector/Config.in
```kconfig
config BR2_PACKAGE_BOOT_SELECTOR
	bool "boot selector"
	help
	  boot selector, enter charging mode or system
```

## system/app-d304-bt/Config.in
```kconfig
config BR2_PACKAGE_APP_D304_BT
	bool "app-d304-bt"
	help
	  app-d304-main app 

	  http://www.infotm.com/
```

## system/app-d304-ft/Config.in
```kconfig
config BR2_PACKAGE_APP_D304_FT
	bool "app-d304-ft"
	default n
	help
	  d304 factory test app

	  http://www.infotm.com/
```

## system/app-d304-main/Config.in
```kconfig
config BR2_PACKAGE_APP_D304_MAIN
	bool "app-d304-main"
	help
	  app-d304-main p2p app

	  http://www.infotm.com/
```
