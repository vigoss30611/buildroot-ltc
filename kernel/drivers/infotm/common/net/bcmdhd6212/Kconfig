## kernel/drivers/infotm/common/net/bcmdhd6212/Kconfig
```kconfig
config BCMDHD_6212
	tristate "Broadcom FullMAC wireless cards support"
	---help---
	  This module adds support for wireless adapters based on
	  Broadcom FullMAC chipset.

config BCMDHD_FW_PATH
	depends on BCMDHD_6212
	string "Firmware path"
	default "/etc/firmware/fw_bcmdhd.bin"
	---help---
	  Path to the firmware file.

config BCMDHD_NVRAM_PATH
	depends on BCMDHD_6212
	string "NVRAM path"
	default "/etc/firmware/nvram.txt"
	---help---
	  Path to the calibration file.

config BCMDHD_CONFIG_PATH
	depends on BCMDHD_6212
	string "Config path"
	default "/etc/firmware/config.txt"
	---help---
	  Path to the driver configuration file.

config BCMDHD_WEXT
	bool "Enable WEXT support"
	depends on BCMDHD_6212 && CFG80211 = n
	select WIRELESS_EXT
	select WEXT_PRIV
	help
	  Enables WEXT support
config DHD_USE_STATIC_BUF
	bool "use static buf"
	default y
	help
	  Enables STATIC buf support

choice
	prompt "Enable Chip Interface"
	depends on BCMDHD_6212
	---help---
		Enable Chip Interface.
config BCMDHD_SDIO
		bool "SDIO bus interface support"
		depends on BCMDHD_6212 && MMC
config BCMDHD_PCIE
		bool "PCIe bus interface support"
		depends on BCMDHD_6212 && PCI
endchoice

choice
	depends on BCMDHD_6212 && BCMDHD_SDIO
	prompt "Interrupt type"
	---help---
		Interrupt type
config BCMDHD_OOB
	depends on BCMDHD_6212 && BCMDHD_SDIO
	bool "Out-of-Band Interrupt"
	default y
	---help---
		Interrupt from WL_HOST_WAKE.
config BCMDHD_SDIO_IRQ
	depends on BCMDHD_6212 && BCMDHD_SDIO
	bool "In-Band Interrupt"
	---help---
	  Interrupt from SDIO DAT[1]
endchoice
```

## kernel/drivers/infotm/common/net/esp8089/esp_prealloc_V2.4/Kconfig
```kconfig
config ESP8089_PREALLOC
	 bool "ESP8089_PREALLOC"
    default y
    help
      ESP8089_PREALLOC
```

## kernel/drivers/infotm/common/net/imap_gmac_ethernet/Kconfig
```kconfig
#
# IMAP GMAC ETHERNET CONFIGURATION
#

menuconfig IMAP_GMAC_ETHERNET
	tristate "Imap Gmac Ethernet"
	default n
	---help---
	  IMAP Supporting for GMAC chipset
	  
	  To compile this driver as a module, choose [M] here. The module
	  will be called imap_eth.

if IMAP_GMAC_ETHERNET
choice
	bool "if you went to choose omc300 eth phy, you need choose codec ip2906 first"

config OMC300_ETH_PHY
	tristate "OMC300 ETH PHY"
	depends on SND_SOC_IP2906
	help
		This enables support omc300 eth phy driver
endchoice
endif
```

## kernel/drivers/infotm/common/net/mtk7601U_wifi/Kconfig
```kconfig
config MTK7601U_WIFI
	tristate "MediaTek 7601 USB WIFI"
	depends on USB && m
	select INFOTM_SWITCH
	---help---
	  Help message of MTK7601U
```

## kernel/drivers/infotm/common/net/rtl8188EUS_rtl8189ES_linux_v4.3.15_13239.20150112/Kconfig
```kconfig
config RTL8188EU
	tristate "Realtek 8188E USB WiFi smart link"
	depends on USB
	---help---
	  Help message of RTL8188EU
```

## kernel/drivers/infotm/common/net/rtl8188EUS_wifi/Kconfig
```kconfig
config RTL8188EUS_WIFI
	tristate "Realtek 8188E USB WiFi"
	depends on USB && m
	select INFOTM_SWITCH
	---help---
	  Help message of RTL8188EU
```

## kernel/drivers/infotm/common/net/rtl8189ES_wifi/Kconfig
```kconfig
config RTL8189ES_WIFI
	tristate "Realtek 8189E SDIO WiFi"
	default n
	---help---
	  Help message of RTL8189ES
```

## kernel/drivers/infotm/common/otg/Kconfig
```kconfig
menuconfig INFOTM_OTG
        tristate "Infotm OTG driver support"
        default y
        help
        Say Y here Infotm OTG driver support.

if INFOTM_OTG

config DWC_OTG
        tristate "Synopsis DWC_OTG support"
        help
          This driver supports Synopsis DWC_OTG IP core
		  embebbed on many SOCs (ralink, infineon, etc)

choice
        prompt "USB Operation Mode"
        depends on DWC_OTG
        default DWC_OTG_HOST_ONLY

config DWC_OTG_HOST_ONLY
        bool "HOST ONLY MODE"
        depends on DWC_OTG

config DWC_OTG_DEVICE_ONLY
        bool "DEVICE ONLY MODE"
        depends on DWC_OTG
	select USB_GADGET_IMAPX800

config DWC_OTG_DOUBLE
	bool "HOST AND DEVICE MODE"
	depends on DWC_OTG

endchoice

choice
        prompt "OTG mode judge method"
        depends on DWC_OTG_DOUBLE
        default DWC_OTG_DOUBLE_EXTRAID

config DWC_OTG_DOUBLE_EXTRAID
        bool "OTG mode judged by extraid"
        depends on DWC_OTG

config DWC_OTG_DOUBLE_MANUAL
        bool "OTG mode judged by manual"
        depends on DWC_OTG

endchoice

choice
        prompt "Platform"
        depends on DWC_OTG
        default DWC_OTG_LANTIQ

config DWC_OTG_LANTIQ
        bool "Lantiq"
        depends on LANTIQ
        help
          Danube USB Host Controller
		  platform support
endchoice

config DWC_OTG_DEBUG
        bool "Enable debug mode"
        depends on DWC_OTG

endif
```

## kernel/drivers/infotm/common/power/Kconfig
```kconfig
menuconfig INFOTM_POWER
	bool "InfoTM power driver support"
	default n
	help
	 INFOTM power driver support

if INFOTM_POWER
config BATTERY_IMAPX
	bool "iMAPx battery driver"
	default n
	help
	  battery driver for iMAPx
endif
```

## kernel/drivers/infotm/common/pwm/Kconfig
```kconfig
menuconfig INFOTM_PWM
		bool "Infotm pwm support"
		default n
		select PWM
		help
		This is the Infotm internal PWM driver
if INFOTM_PWM
config PWM_IMAPX
		tristate "iMAPx PWM driver"
        default n                 
		help                       
			PWM driver for iMAPx      

config IMAPX_BEEP
		tristate "Imapx PWM based beep driver"
        default n                 
		help                       
			PWM driver for iMAPx      
			
endif
```

## kernel/drivers/infotm/common/rtc/Kconfig
```kconfig
menuconfig INFOTM_RTC
        bool "Infotm RTC support"
        default y
        help
        This is the Infotm internal RTC driver

if INFOTM_RTC


config RTC_DRV_IMAPX
       tristate "iMAPx RTC driver"
        default y
       help
        RTC driver for iMAPx, besides normal clock, it also provides
        1 to 64Hz periodical interrupt, alarm interrupt & wake-up
        features.

comment "I2C RTC drivers"
	depends on I2C

if I2C

config RTC_DRV_PCF8563_IMAPX
	tristate "Philips PCF8563 for iMAPx"
	default y
	help
	  If you say yes here you get support for the
	  Philips PCF8563 RTC chip.

	  This driver can also be built as a module. If so, the module
	  will be called rtc-pcf8563.

endif # I2C
endif
```

## kernel/drivers/infotm/common/sensor/Kconfig
```kconfig
menuconfig INFOTM_GSENSOR
        bool "Infotm G-sensor Support"
	default n
        help
        Say Y here, and a list of support G-sensors will be displayed.

if INFOTM_GSENSOR


config SENSOR_MMA7660
	tristate "Freescale MMA7660 acceleration sensor susport"
	depends on I2C=y
	default n
	help
	If you say yes here you get support for Freescale's
	acceleration sensors MMA7660.

config SENSOR_STK8312
	tristate "Freescale STK8312 acceleration sensor susport"
	depends on I2C=y
	default n
	help
	If you say yes here you get support for Freescale's
	acceleration sensors STK8312.

config SENSOR_MIR3DA
	tristate "Freescale BMA280 acceleration sensor susport"
	depends on I2C=y
	default n
	help
	If you say yes here you get support for Freescale's
	acceleration sensors BMA280.

endif
```

## kernel/drivers/infotm/common/sound/Kconfig
```kconfig
menuconfig INFOTM_SOUND
	bool "Infotm SoC Audio"
	depends on SND_SOC
	help
	Say Y here, and a list of supported audio will be displayed.

if INFOTM_SOUND
config INFOTM_AUTO_ENABLE_SPK
        bool "playback auto open and close speaker"
  default n

source "drivers/infotm/common/sound/codecs/Kconfig"
source "drivers/infotm/common/sound/configuration/Kconfig"
source "drivers/infotm/common/sound/imapx/Kconfig"
endif
```

## kernel/drivers/infotm/common/sound/codecs/Kconfig
```kconfig
config SND_SOC_ES8328
	bool

config SND_SOC_ES8323
	bool

config SND_SOC_ALC5631
	bool

config SND_SOC_FR1023
	bool

config SND_SOC_TQLP9624
	bool

config SND_SOC_VIRTUAL
	bool

config SND_SOC_IP6205
	bool

config SND_SOC_IP2906
	bool
```

## kernel/drivers/infotm/common/sound/configuration/Kconfig
```kconfig
#menu "SoC Audio for the INFOTM SOC"
config SND_IMAPX_SOC
	tristate "SoC Audio for the Infotm Imapx chips"
	depends on SND_SOC
	select SND_PCM
	help
		Say Y or M if you want to add support for codecs attached to
		the AC97, I2S interface. You will also need
		to select the audio interfaces to support below.

if SND_IMAPX_SOC

config SND_IMAPX_SOC_ES8328
    tristate "SoC Audio support for IMAPX - ES8328"
	depends on SND_IMAPX_SOC
	select SND_SOC_ES8328
	help
		Say Y if you want to add support for SoC audio on imapx
		or imapx with the es8328.

config SND_IMAPX_SOC_ES8323
	tristate "SoC Audio support for IMAPX - ES8323"
	depends on SND_IMAPX_SOC
	select SND_SOC_ES8323
	help
		Say Y if you want to add support for SoC audio on imapx
		or imapx with the es8323.

config SND_IMAPX_SOC_FR1023
	tristate "SoC Audio support for IMAPX - FR1023"
	depends on SND_IMAPX_SOC
	select SND_SOC_FR1023
	help
		Say Y if you want to add support for SoC audio on imapx
		or imapx with the fr1023.
config SND_IMAPX_SOC_ALC5631
    tristate "SoC Audio support for IMAPX - ALC5631"
    depends on SND_IMAPX_SOC
    select SND_SOC_ALC5631
    help
        Say Y if you want to add support for SoC audio on imapx
        or imapx with the alc5631.

config SND_IMAPX_SOC_TQLP9624
	tristate "SoC Audio support for IMAPX - Acodec"
	depends on SND_IMAPX_SOC
	select SND_SOC_TQLP9624
	help
		Say Y if you want to add support for SoC audio on imapx
		or imapx with the acodec.
config SND_IMAPX_SOC_FR1023
	tristate "SoC Audio support for IMAPX - Fr1023"
	depends on SND_IMAPX_SOC
	select SND_SOC_FR1023
	help
		Say Y if you want to add support for SoC audio on imapx
		or imapx with the acodec.

config SND_IMAPX_SOC_IP6205
	tristate "Soc Audio support for IMAPX - IP620x"
	depends on SND_IMAPX_SOC
	select SND_SOC_IP6205
	help
		Say Y if you want to add support for Soc audio on imapx
		or imapx with the acodec.

config SND_IMAPX_SOC_IP2906
	tristate "Soc Audio support for IMAPX - IP2906"
	depends on SND_IMAPX_SOC
	select SND_SOC_IP2906
	help
		Say Y if you want to add support for Soc audio on imapx
		or imapx with the acodec.

config SND_IMAPX_SOC_SPDIF
    tristate "SoC Audio support for IMAPX - Spdif"
    depends on SND_IMAPX_SOC
    help
        This is option for support spdif interface

config SND_IMAPX_SOC_VIRTUAL
	tristate "SoC Audio support for IMAPX - Virtual"
	depends on SND_IMAPX_SOC
	select SND_SOC_VIRTUAL
	help
		Say Y if you want to add support for SoC audio on imapx
		or imapx with the vitual.

endif
```

## kernel/drivers/infotm/common/sound/imapx/Kconfig
```kconfig
#menu "SoC Audio for the INFOTM SOC"
if SND_IMAPX_SOC

config SND_IMAPX_SOC_IIS
    tristate "SoC Audio transfer for IMAPX - IIS"
	help
		Say Y if you want to add support for SoC audio on imapx
		or imapx with the iis.

config SND_IMAPX_SOC_PCM
	tristate "SoC Audio transfer for IMAPX - PCM"
	help
		Say Y if you want to add support for SoC audio on imapx
		or imapx with the pcm.

config SND_IMAPX_SOC_DMA
    tristate "SoC Audio memcpy for IMAPX - DMA pl330"
    depends on PL330_DMA
    help
        Say Y if you want to add support for SoC audio on imapx
        or imapx with the dma.

config INFOTM_AUTO_ENABLE_SPK
	tristate "auto enable spk"
	default n
	help
		Say Y if you want to auto enable spk.

config TQLP9624_ADC
	tristate "support adc for tqlp9624"
	depends on SND_IMAPX_SOC_DMA
	depends on SND_SOC_TQLP9624
	help
		Say Y if you want to support adc for temp.
 
endif
```

## kernel/drivers/infotm/common/spi/Kconfig
```kconfig
menuconfig INFOTM_SPI
	bool "Infotm SPI support"
	  default n
	help
	  This is the Infotm internal SPI driver

if INFOTM_SPI

config IMAPX_SPI
	tristate "iMAPx SPI(PL022) master driver"
	  default n
	help
	  iMAPx SPI driver

config IMAPX_SPIMUL
	tristate "iMAPx 4-Wire SPI  master driver"
	  default n
	help
	  iMAPx SPIMUL driver
config LCD_SPI
	tristate "SPI slave device (lcd) driver"
	  default n
   depends on IMAPX_SPI
	help
	  iMAPx SPI slave device LCD  driver

endif
```

## kernel/drivers/infotm/common/spi_ftl/Kconfig
```kconfig
#
# Infotm spi norflash FTL configuration
#

menu "Infotm norfalsh ftl support"

config INFOTM_NORFALSH_FTL
	bool "Infotm Norflash ftl SUPPORT"
	default y
        help
		This is nor flash ftl suport

endmenu
```

## kernel/drivers/infotm/common/switch/Kconfig
```kconfig
config INFOTM_SWITCH
    tristate "Infotm board configuration switch"
    help
      Say Y to enabled board configuration device. User layer
      programs can access board items through this interface.
```

## kernel/drivers/infotm/common/timer/Kconfig
```kconfig
config INFOTM_CMN1_TIMER
        bool "Infotm cmn timer 1 API support"
        default y
```

## kernel/drivers/infotm/common/touchscreen/Kconfig
```kconfig
menuconfig INFOTM_TOUCHSCREEN
        bool "Infotm Touchscrenns support"
        default n
        help
			Kinds of TS IC drivers

if INFOTM_TOUCHSCREEN


config	CTP_GSLX682
       tristate "gslX682 CTP for x9 EVB"
	   depends on I2C
	   default n
       help
	   Say Y here if you want to use the GSLX682 of x9 EVB.
config	CTP_GSLX681
       tristate "gslX681 CTP for x9 EVB"
	   depends on I2C
	   default n
       help
	   Say Y here if you want to use the GSLX681 of x9 EVB.

config	CTP_GSLX680_Q8
       tristate "gslX680 CTP for Q8"
	   depends on I2C
	   default n
       help
	   Say Y here if you want to use the GSLX680_Q8 of Q8.

config	CTP_GT9147
       tristate "gt9147 CTP for Q3"
	   depends on I2C
	   default n
       help
	   Say Y here if you want to use the GT9147 of Q3.
	   
config	CTP_GT911
       tristate "gt911 CTP for Q3"
	   depends on I2C
	   default n
       help
	   Say Y here if you want to use the GT911 of Q3.
endif
```

## kernel/drivers/infotm/common/watchdog/Kconfig
```kconfig
menuconfig INFOTM_WDT
        bool "Infotm watchdog driver support"
        default n
	select WATCHDOG
        help
             Infotm watchdog timer driver support. say yes ifneed
if INFOTM_WDT
config WDT_IMAPX
        tristate "iMAPx wdt driver"
        default n
	help
		wdt driver for iMAPx
endif
```

## kernel/drivers/infotm/coronampw/Kconfig
```kconfig
 menuconfig INFOTM_DRV_CORONAMPW
     bool "Infotm CORONAMPW Series Support"
     depends on ARCH_CORONAMPW && INFOTM_SPECIAL
     help
         Infotm CORONAMPW Series support

if INFOTM_DRV_CORONAMPW
source "drivers/infotm/coronampw/clk/Kconfig"
source "drivers/infotm/coronampw/gpio/Kconfig"
source "drivers/infotm/coronampw/input/Kconfig"
source "drivers/infotm/coronampw/display/Kconfig"
source "drivers/infotm/coronampw/dpmu/Kconfig"
source "drivers/infotm/coronampw/emif/Kconfig"
source "drivers/infotm/coronampw/mfd/Kconfig"
source "drivers/infotm/coronampw/regulator/Kconfig"
source "drivers/infotm/coronampw/ispost/Kconfig"
endif
```

## kernel/drivers/infotm/coronampw/clk/Kconfig
```kconfig
 #                                                 
 #  Clock device configuration                     
 #                                                 
 #                                                 
menuconfig CORONAMPW_CLK                           
        bool "CORONAMPW clock driver support"
		depends on COMMON_CLK
        default n                                  
        help                                       
               Infotm input device driver suport   
```
