## kernel/drivers/infotm/common/InfotmMedia/external/project/venc_drv_8270/Kconfig
```kconfig
#
# Kconfig InfotmMedia venc 8270 driver.
#
# Copyright (c) 2009~2014 ShangHai Infotm Ltd all rights reserved.
#
#

menuconfig INFOTM_MEDIA_VENC_8270_SUPPORT
        bool "InfotmMedia ven 8270 driver support"
        default y

if INFOTM_MEDIA_VENC_8270_SUPPORT

config VENC_DVFS_SUPPORT
	bool "venc DVFS support"
	depends on INFOTM_MEDIA_VENC_8270_SUPPORT
	default y

endif
```

## kernel/drivers/infotm/common/InfotmMedia/external/project/venc_h265_v4/Kconfig
```kconfig
 #
 #  Clock device configuration
 #
 #
config INFOTM_MEDIA_VENC_H265_V4_SUPPORT
        tristate "APOLLO venc hevc h2v4 support"
        default n
        help
               Infotm hevc video encoder support
```

## kernel/drivers/infotm/common/Kconfig
```kconfig
#
#  Infotm common drivers
#

menuconfig INFOTM_DRV_COMMON
	 tristate  "Infotm common drivers support"
		depends on INFOTM_SPECIAL 
	 help  
			Infotm common drivers  support
if INFOTM_DRV_COMMON
source "drivers/infotm/common/adc/Kconfig"
source "drivers/infotm/common/hwmon/Kconfig"
source "drivers/infotm/common/items/Kconfig"
source "drivers/infotm/common/mmc/Kconfig"
source "drivers/infotm/common/spi_ftl/Kconfig"
source "drivers/infotm/common/leds/Kconfig"
source "drivers/infotm/common/rtc/Kconfig"
source "drivers/infotm/common/i2c/Kconfig"
source "drivers/infotm/common/pwm/Kconfig"
source "drivers/infotm/common/display/Kconfig"
source "drivers/infotm/common/display2/Kconfig"
source "drivers/infotm/common/backlight/Kconfig"
source "drivers/infotm/common/touchscreen/Kconfig"
source "drivers/infotm/common/otg/Kconfig"
source "drivers/infotm/common/InfotmMedia/Kconfig"
source "drivers/infotm/common/net/Kconfig"
source "drivers/infotm/common/sound/Kconfig"
source "drivers/infotm/common/belt/Kconfig"
source "drivers/infotm/common/switch/Kconfig"
source "drivers/infotm/common/sensor/Kconfig"
source "drivers/infotm/common/camera/Kconfig"
source "drivers/infotm/common/dvfs/Kconfig"
source "drivers/infotm/common/dvfs_apollo/Kconfig"
source "drivers/infotm/common/spi/Kconfig"
source "drivers/infotm/common/bt/Kconfig"
source "drivers/infotm/common/fr/Kconfig"
source "drivers/infotm/common/watchdog/Kconfig"
source "drivers/infotm/common/env/Kconfig"
source "drivers/infotm/common/power/Kconfig"
source "drivers/infotm/common/timer/Kconfig"
endif
```

## kernel/drivers/infotm/common/adc/Kconfig
```kconfig
menuconfig INFOTM_ADC
		bool "Infotm ADC support"
		default n
		help
		This is the Infotm internal ADC driver
if INFOTM_ADC
config ADC_IMAPX
		tristate "iMAPx ADC driver"
        default n                 
		help                       
			ADC driver for iMAPx      
config ADC_IP6303
		tristate "IP6303 ADC driver"
        default n                 
		help                       
			ADC driver for IP6303      
config ADC_KEYS_IMAPX
		tristate "iMapx ADC based KEYs driver implementation"
		depends on ADC_IMAPX
		help 
		        Keys driver which base on adc sample driver
config ADC_KEYS_IP6303
		tristate "IP6303 ADC based KEYs driver implementation"
		depends on ADC_IP6303
		help 
		        Keys driver which base on adc sample driver

endif
```

## kernel/drivers/infotm/common/backlight/Kconfig
```kconfig
menuconfig INFOTM_BACKLIGHT
        bool "Infotm Backlight support"
        default y
        help
        This is the Infotm internal Backlight driver

if INFOTM_BACKLIGHT


config BACKLIGHT_IMAPX
       tristate "iMAPx Backlight driver"
	   default y
       help
        backlight driver for iMAPx.
endif
```

## kernel/drivers/infotm/common/belt/Kconfig
```kconfig
config INFOTM_BELT
	tristate "A great belt that connects kernel and user space"
	default y
```

## kernel/drivers/infotm/common/bt/Kconfig
```kconfig
menuconfig INFOTM_BT
		bool "Infotm BT Support"
		help
		Say Y here, and a list of support BT will be displayed.

if INFOTM_BT

config BCM6212_BT
	tristate "BCM 6212 bluetooth support"
	help
	If you say yes here you get support for BCM 6212 bluetooth.

endif
```

## kernel/drivers/infotm/common/camera/Kconfig
```kconfig
#
# CAMERA device configuration
#

menuconfig INFOTM_VIDEO_CAPTURE
	bool "infotm Video capture driver support"
	default y
	help
		choose a video capture driver for your platform:
		imapx210, imapx15, imapx9s	---- camif
		imapx820, imapx9			---- isp

if INFOTM_VIDEO_CAPTURE
source "drivers/infotm/common/camera/sensors/Kconfig"
source "drivers/infotm/common/camera/isp/Kconfig"
source "drivers/infotm/common/camera/camif/Kconfig"
source "drivers/infotm/common/camera/bridge/Kconfig"
#source "drivers/infotm/common/camera/sensors/camif"
source "drivers/infotm/common/camera/csi/Kconfig"
endif
```

## kernel/drivers/infotm/common/camera/bridge/Kconfig
```kconfig
menuconfig INFOTM_DUAL_BRIDGE
	bool "Infotm dual dvp bridge"
	default y
	help
		you should select_on all of them
		
if INFOTM_DUAL_BRIDGE

config INFOTM_BRIDGE
	tristate "infotm bridge core"
	default y

config SX2_BRIDGE
	tristate "apollo3 sx2 dvp bridge"
	depends on ARCH_APOLLO3 && INFOTM_BRIDGE
	default y

config XC9080_BRIDGE
	tristate "xc9080 mipi bridge"
	depends on INFOTM_BRIDGE
	default y

config STK3855_BRIDGE
	tristate "stk3855 dvp bridge"
	depends on INFOTM_BRIDGE
	default y

endif
```

## kernel/drivers/infotm/common/camera/camif/Kconfig
```kconfig
config INFOTM_CAMIF                                         
    tristate "InfoTM imapx SOC camera camif driver"                
    depends on VIDEO_V4L2 && I2C && VIDEO_V4L2_SUBDEV_API        
    select VIDEOBUF2_DMA_CONTIG                                  
	---help---                                                   
    This is a v4l2 driver for IMPAX-CAMIF SoC series camera        
    host interface (CAMIF).                                      
config CAMIF_EXTRA_OCLK
    tristate "select yes if camif host need extra Mclk output"                
    depends on INFOTM_CAMIF        
config IMAPX_Q3EVB_V1_1
    tristate "select yes if q3evb_v1.1"                
    depends on CAMIF_EXTRA_OCLK        
```

## kernel/drivers/infotm/common/camera/csi/Kconfig
```kconfig
menuconfig INFOTM_MIPI_CSI
	bool "Infotm mipi csi controller"
	default y
	help
		you should select_on all of them
		
if INFOTM_MIPI_CSI

config INFOTM_MIPI_CSI_CORE
	bool "infotm csi core"
	default y

endif
```

## kernel/drivers/infotm/common/camera/isp/Kconfig
```kconfig
config INFOTM_ISP                                           
    tristate "InfoTM imapx SOC camera isp driver"                
    depends on VIDEO_V4L2 && I2C && VIDEO_V4L2_SUBDEV_API        
    select VIDEOBUF2_DMA_CONTIG                                  
	---help---                                                   
    This is a v4l2 driver for IMPAX-ISP SoC series camera        
    host interface (ISP).                                        
```

## kernel/drivers/infotm/common/camera/sensors/Kconfig
```kconfig
menuconfig INFOTM_CAMERA_SENSOR
		bool "Infotm camera sensor List"
		default y
		help
		 you should select_on all of them

if INFOTM_CAMERA_SENSOR

if !MEDIA_SUBDRV_AUTOSELECT
config VIDEO_GC0308
	tristate "Glalory core  GC0308 sensor for demo"
	depends on I2C && VIDEO_V4L2 && VIDEO_V4L2_SUBDEV_API && INFOTM_CAMERA_SENSOR
	---help---
		This is a V4L2 sensor-level driver for the Gcore
		GC0308_DEMO  camera sensors.

config VIDEO_GC2035
	tristate "Glalory core  GC2035 sensor for demo"
	depends on I2C && VIDEO_V4L2 && VIDEO_V4L2_SUBDEV_API && INFOTM_CAMERA_SENSOR
	---help---
	This is a V4L2 sensor-level driver for the Gcore
	GC2035_DEMO  camera sensors.  

config VIDEO_GC0329
	tristate "Glalory core  GC0329 sensor for demo"
	depends on I2C && VIDEO_V4L2 && VIDEO_V4L2_SUBDEV_API && INFOTM_CAMERA_SENSOR
	---help---
	This is a V4L2 sensor-level driver for the Gcore
	GC0329_DEMO  camera sensors.  

config VIDEO_AR330
	tristate "AR330 sensor for demo"
	depends on I2C && VIDEO_V4L2 && VIDEO_V4L2_SUBDEV_API && INFOTM_CAMERA_SENSOR
	---help---
	This is a V4L2 sensor-level driver for the Gcore
	AR330 sensor camera sensors.
endif

config DDK_SENSOR
	tristate "sensor driver for ddk2.7.0"
	default m

config XC9080
	bool "sensor driver for XC9080"
	default n

if XC9080

choice XC9080_DEVICE_TYPE
	bool "choice type of xc9080 driver"
	default XC9080_DEVICE_TYPE_ISP

	comment "must one option selected"

config XC9080_DEVICE_TYPE_ISP
	bool "xc9080 driver for ISP"
	depends on I2C
	help
	  xc9080 driver compatible with ISP.

config XC9080_DEVICE_TYPE_V4L2
	bool "xc9080 driver for camif V4L2"
	depends on I2C && VIDEO_V4L2 && VIDEO_V4L2_SUBDEV_API && INFOTM_CAMERA_SENSOR && INFOTM_CAMIF
	select XC9080_V4L2
	help
	  xc9080 driver compatible with V4L2.

endchoice

if XC9080_DEVICE_TYPE_ISP
config XC9080_ISP
	tristate "xc9080 driver for ISP"
	depends on I2C
	default n
	help
	  xc9080 driver for ISP.
endif

if XC9080_DEVICE_TYPE_V4L2
config XC9080_V4L2
	bool "xc9080 driver for V4L2"
	depends on I2C && VIDEO_V4L2 && VIDEO_V4L2_SUBDEV_API && INFOTM_CAMERA_SENSOR && INFOTM_CAMIF
	default n
	help
	  xc9080 driver for V4L2.
endif

config UVC_NO_PMU
	bool "set UVC NO PMU"
	default n
	help
	  Select this option if xc9080 need PMU to offer power.
endif

config USE_PCM_CLK
	bool "sensor clock used PCM clock"
	depends on DDK_SENSOR || XC9080

config INFOTM_LANCHOU_CAMERA
	bool " lanchou sensor "
	depends on DDK_SENSOR || XC9080

config VIDEO_STK3855
	tristate "STK3855 sensor birgde ic"
	depends on DVP_CAMERA_SENSOR && I2C && INFOTM_CAMERA_SENSOR
	---help---
	This is a i2c sensor-level driver for the
	STK3855 DVP camera sensors brigde ic.

config SENSOR_POWER_UP
	bool "power up  for sensor"
	default y

config SENSOR_ITEM_UTILS
	bool "item utils for sensor"
	default y

config SENSOR_DVP_WRAPPER
	bool "dvp wrapper for sensor"
	default y

endif
```

## kernel/drivers/infotm/common/display/Kconfig
```kconfig
menuconfig INFOTM_COMMON_DISPLAY
        bool "Infotm display support"
        default n
	select FB_CFB_FILLRECT
        select FB_CFB_COPYAREA
        select FB_CFB_IMAGEBLIT
	select FB_SYS_FILLRECT
        select FB_SYS_COPYAREA
        select FB_SYS_IMAGEBLIT
	select FB_SYS_FOPS
        help
          This enables support for the Infotm display driver.

if INFOTM_COMMON_DISPLAY

config DISPLAY_IMAPX
      bool "iMAPx display driver 122343444"
           default y
       help
         This enables support for the iMAPx series display driver.

endif
```

## kernel/drivers/infotm/common/display2/Kconfig
```kconfig
menuconfig INFOTM_DISPLAY2
	bool "Infotm display2 support"
	default n
        select FB_CFB_FILLRECT
        select FB_CFB_COPYAREA
        select FB_CFB_IMAGEBLIT
	help
	  This enables support for the display2 driver

if INFOTM_DISPLAY2

choice DISPLAY2_LOGO
	bool "kernel logo"
        default DISPLAY2_NOLOGO
        help
          kernel logo

config DISPLAY2_NOLOGO
	bool "No Logo"
	help
	  no kernel logo

config DISPLAY2_LOGO1
        bool "Logo1"
        help
          logo1

config DISPLAY2_LOGO2
        bool "Logo2"
        help
          logo2

config DISPLAY2_LOGO3
        bool "Logo3"
        help
          logo3

config DISPLAY2_LOGO4
        bool "Logo4"
        help
          logo4

config DISPLAY2_LOGO5
        bool "Logo5"
        help
          logo5

endchoice

choice DISPLAY2_LOGO_SCALE
	bool "logo scale"
	default DISPLAY2_LOGO_SCALE_NONSCALE
	help
	  kernel logo scale type

config DISPLAY2_LOGO_SCALE_NONSCALE
	bool "None scale"
	help
	  not scale, centered on the screen

config DISPLAY2_LOGO_SCALE_FIT
	bool "Fit screen, keep ratio, may have black area"
	help
	  fit screen, keep ratio, may have black area

config DISPLAY2_LOGO_SCALE_STRETCH
	bool "Stretch to cover full screen, not keep ratio"
	help
	  stretch to cover full screen, not keep ratio

endchoice

config DISPLAY2_LOGO_BACKGROUND
	string "logo background color (in RGB888 HEX format)"
	default "0"
	help
	  overlay background color for kernel logo display, in RGB888 HEX format, e.g 0x8800FF

endif
```

## kernel/drivers/infotm/common/dvfs/Kconfig
```kconfig
menuconfig INFOTM_CPUFREQ
       bool "Infotm cpu cpufreq support"
       default y
       help
               Say Y to select the imapx cpufreq drivers if CPUFREQ is needed
if INFOTM_CPUFREQ      

config  CPU_FREQ_GOV_INFODEMAND
        tristate "'infodemand' cpufreq policy governor"
        depends on INFOTM_CPUFREQ
        select CPU_FREQ_TABLE
        default y
        help
        This Cpufreq governor is designed for infotm imapx800 series AP. It is based on ondemand 
        interactive and cpu hotplugs. Y to seletced. diselect it means use perfomance as defaulted

config INFOTM_VOL_FIT
		tristate "infotm dynamic voltage scaling policy"
		depends on INFOTM_CPUFREQ
		default y
		help
		This driver is designed for infotm dynamic voltage scaling function.

config INFOTM_CPU_FIT
		tristate "infotm cpu hotplug policy"
		depends on INFOTM_CPUFREQ
		default y
		help
		This driver is designed for infotm cpu function.
endif
```

## kernel/drivers/infotm/common/dvfs_apollo/Kconfig
```kconfig
menuconfig APOLLO_CPUFREQ
       bool "Apollo cpu cpufreq support"
       default n
       help
               Say Y to select the apollo cpufreq drivers if CPUFREQ is needed
if APOLLO_CPUFREQ      

config APOLLO_VOL_FIT
		tristate "apollo manual freq scaling policy"
		depends on APOLLO_CPUFREQ
		default y
		help
		This driver is designed for apollo manual freq scaling function.

config APOLLO_CPU_FIT
		tristate "apollo cpu hotplug policy"
		depends on APOLLO_CPUFREQ
		default y
		help
		This driver is designed for apollo cpu function.
endif
```

## kernel/drivers/infotm/common/env/Kconfig
```kconfig
#
# Modules base on InfoTM
#

config INFOTM_ENV
	tristate "Infotm uboot env"
	default y
	help
	  Say Y to init uboot env. User layer programs can access env through this interface.
```

## kernel/drivers/infotm/common/fr/Kconfig
```kconfig
config INFOTM_FR
	tristate "Frame Ring"
	default n
	help
	  Frame Ring (FR) manages ring-buffer of frames between different
	  video devices.

config INFOTM_FR_TEST
	tristate "Test code for frame-ring"
	default n
	depends on INFOTM_FR

config INFOTM_FR_STATISTICS
	tristate "Collect time data and analysis performence"
	default n
	depends on INFOTM_FR
```

## kernel/drivers/infotm/common/hwmon/Kconfig
```kconfig
menuconfig INFOTM_HWMON
	bool "Infotm Hardware monitor support"
	default y
	select HWMON
	help 
	This is for Infotm hardware monitor sensors
if INFOTM_HWMON
config LIGHTSENSOR_PT550
	tristate "light-sensor pt550 sensor driver"
	default y
	help
	 keep this disselected while not sure
endif
```

## kernel/drivers/infotm/common/i2c/Kconfig
```kconfig
menuconfig INFOTM_I2C
        bool "Infotm I2C support"
        default y
        help
        This is the Infotm internal I2C driver

if INFOTM_I2C


config I2C_IMAPX
       tristate "iMAPx I2C driver"
        default y
       help
        I2C driver for iMAPx

config I2C_SLAVE_IMAPX
	tristate "iMAPx I2C Slave driver"
	default y
	help
        I2C as slave driver for iMAPx
endif
```

## kernel/drivers/infotm/common/items/Kconfig
```kconfig
#
# Modules base on InfoTM DSP
#

config INFOTM_ITEM
	tristate "Infotm board configuration items"
	default y
	help
	  Say Y to enabled board configuration device. User layer
	  programs can access board items through this interface.
```

## kernel/drivers/infotm/common/leds/Kconfig
```kconfig
#
# infotm led driver
#


menuconfig INFOTM_LEDS
	bool "Infotm leds SUPPORT"
	default n
	select LEDS_CLASS
        help
		This is leds driver
if INFOTM_LEDS
config LEDS_IMAPX
        tristate "iMAPx leds driver"
        default n
	help
		LED driver for iMAPx
endif
```
