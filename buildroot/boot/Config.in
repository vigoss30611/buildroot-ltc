## buildroot/boot/Config.in
```kconfig
menu "Bootloaders"

source "buildroot/boot/at91bootstrap/Config.in"
source "buildroot/boot/at91bootstrap3/Config.in"
source "buildroot/boot/at91dataflashboot/Config.in"
source "buildroot/boot/barebox/Config.in"
source "buildroot/boot/boot-wrapper-aarch64/Config.in"
source "buildroot/boot/grub/Config.in"
source "buildroot/boot/lpc32xxcdl/Config.in"
source "buildroot/boot/mxs-bootlets/Config.in"
source "buildroot/boot/syslinux/Config.in"
source "buildroot/boot/uboot/Config.in"
source "buildroot/boot/uboot1/Config.in"
source "buildroot/boot/xloader/Config.in"

endmenu
```

## buildroot/boot/uboot/Config.in
```kconfig
config BR2_PACKAGE_UBOOT
	bool "U-Boot"
	help
	  Build "Das U-Boot" Boot Monitor
if BR2_PACKAGE_UBOOT
config BR2_PACKAGE_UBOOT_LOCAL_SOURCE
	bool "Local source"
	help
	  This option allows to use a local uboot source

config BR2_PACKAGE_UBOOT_LOCAL_PATH
	string "Local path of uboot source"
	default "${TOPDIR}/uboot"
	help
		use local source for uboot, and build outside of source directory

choice
	prompt "Boot Device"
	default BR2_PACKAGE_UBOOT_BOOT_DEVICE_SPI_FLASH

config BR2_PACKAGE_UBOOT_BOOT_DEVICE_SPI_FLASH
	bool "spi-flash"
	help
	  spi flash device
config BR2_PACKAGE_UBOOT_BOOT_DEVICE_EMMC
	bool "emmc"
	help
	  emmc device
config BR2_PACKAGE_UBOOT_BOOT_DEVICE_MMC
	bool "mmc"
	help
	  mmc device
endchoice

config BR2_PACKAGE_UBOOT_BURN_DEVICE_MMC
	bool "Support SD/TF-card as Burn Source"
	default y
	help
	  This option allows to use sd/tf card to burn

config BR2_PACKAGE_UBOOT_BURN_DEVICE_UDC
	bool "Support UDC as Burn Source"
	default n
	help
	  This option allows to use USB linkPC to burn

config BR2_PACKAGE_IROM_SKIP_MMC_CHECK
	bool "Forbid IROM read SD/TF-card"
	default n
	help
	  IROM may get stucked by some bad card, but it is inside the chip and can't be upgraded. This option allow IROM skip checking the card and then we could do all the job in uboot

choice 
	prompt "Board platform type"
	default BR2_TARGET_UBOOT_BOOT_PLAT_SOC 

config BR2_TARGET_UBOOT_BOOT_PLAT_FPGA
	bool "compile for fpga debug"
	help 
		for q3f fpga debug
config BR2_TARGET_UBOOT_BOOT_PLAT_SOC
	bool "compile for common use"
	help 
		for q3f common use
endchoice

endif
```

## buildroot/boot/uboot1/Config.in
```kconfig
config BR2_PACKAGE_UBOOT1
	bool "UBoot1"
	help
	  Build "UBoot1" second Boot Monitor

if BR2_PACKAGE_UBOOT1

choice
	prompt "cpu id"
	default BR2_PACKAGE_UBOOT1_Q3
config BR2_PACKAGE_UBOOT1_APOLLO3
	bool "Apollo-eco"
	help 
		apollo3 uboot1

config BR2_PACKAGE_UBOOT1_Q3F
	bool "Apollo-2"
	help
	  q3f uboot1
config BR2_PACKAGE_UBOOT1_Q3
	bool "Apollo"
	help
	  q3 uboot1
endchoice

endif
```

## buildroot/fs/Config.in
```kconfig
menu "Filesystem images"

config BR2_FS_MAKE_SYSTEM
	bool "Make system image for most files"
	default y
	select BR2_TARGET_ROOTFS_CPIO
	help
	  make most files into system image instead of rootfs, build
	  a ramdisk for rootfs and a system image for real system.

if BR2_FS_MAKE_SYSTEM
choice
	prompt "system.img format"
	default BR2_FS_SYSTEM_NONE
	help
	  Select a rootfs format as system.img and it will be copied
	  to system.img. Select none, you should choice one of the
	  rootfs as system.img.

config BR2_FS_SYSTEM_NONE
	bool "none"
	help
	  Manually choice a rootfs format as system.img later.
	
config BR2_FS_SYSTEM_CLOOP
	bool "cloop"
	select BR2_TARGET_ROOTFS_CLOOP
	help
	  Copy cloop rootfs as system.img.
	
config BR2_FS_SYSTEM_CRAMFS
	bool "cramfs"
	select BR2_TARGET_ROOTFS_CRAMFS
	help
	  Copy cramfs rootfs as system.img.
	
config BR2_FS_SYSTEM_EXT2
	bool "ext2/3/4"
	select BR2_TARGET_ROOTFS_EXT2
	help
	  Copy ext2/3/4 rootfs as system.img.
	
config BR2_FS_SYSTEM_ISO9660
	bool "iso9660"
	select BR2_TARGET_ROOTFS_ISO9660
	help
	  Copy iso9660 rootfs as system.img.
	
config BR2_FS_SYSTEM_JFFS2
	bool "jffs2"
	select BR2_TARGET_ROOTFS_JFFS2
	help
	  Copy jffs2 rootfs as system.img.
	
config BR2_FS_SYSTEM_ROMFS
	bool "romfs"
	select BR2_TARGET_ROOTFS_ROMFS
	help
	  Copy romfs rootfs as system.img.
	
config BR2_FS_SYSTEM_SQUASHFS
	bool "squashfs"
	select BR2_TARGET_ROOTFS_SQUASHFS
	help
	  Copy squashfs rootfs as system.img.
	
config BR2_FS_SYSTEM_TAR
	bool "tar"
	select BR2_TARGET_ROOTFS_TAR
	help
	  Copy tar rootfs as system.img.
	
config BR2_FS_SYSTEM_UBIFS
	bool "ubifs"
	select BR2_TARGET_ROOTFS_UBIFS
	help
	  Copy ubifs rootfs as system.img.
	
endchoice
endif

source "buildroot/fs/cpio/Config.in"
source "buildroot/fs/cloop/Config.in"
source "buildroot/fs/cramfs/Config.in"
source "buildroot/fs/ext2/Config.in"
source "buildroot/fs/initramfs/Config.in"
source "buildroot/fs/iso9660/Config.in"
source "buildroot/fs/jffs2/Config.in"
source "buildroot/fs/romfs/Config.in"
source "buildroot/fs/squashfs/Config.in"
source "buildroot/fs/tar/Config.in"
source "buildroot/fs/ubifs/Config.in"
source "buildroot/fs/yaffs2/Config.in"

endmenu
```

## buildroot/fs/cramfs/Config.in
```kconfig
config BR2_TARGET_ROOTFS_CRAMFS
	bool "cramfs target filesystem"
	help
	  Build a cramfs target filesystem

	  http://sourceforge.net/projects/cramfs/
```

## buildroot/fs/romfs/Config.in
```kconfig
config BR2_TARGET_ROOTFS_ROMFS
	bool "romfs target filesystem"
	help
	  Build a romfs image of the target filesystem.
```

## buildroot/package/Config.in.host
```kconfig
menu "Host utilities"

source "buildroot/package/dfu-util/Config.in.host"
source "buildroot/package/dosfstools/Config.in.host"
source "buildroot/package/e2fsprogs/Config.in.host"
source "buildroot/package/genext2fs/Config.in.host"
source "buildroot/package/genimage/Config.in.host"
source "buildroot/package/genpart/Config.in.host"
source "buildroot/package/lpc3250loader/Config.in.host"
source "buildroot/package/mtools/Config.in.host"
source "buildroot/package/omap-u-boot-utils/Config.in.host"
source "buildroot/package/openocd/Config.in.host"
source "buildroot/package/parted/Config.in.host"
source "buildroot/package/sam-ba/Config.in.host"
source "buildroot/package/sunxi-tools/Config.in.host"
source "buildroot/package/uboot-tools/Config.in.host"

endmenu
```

## buildroot/package/dfbsee/Config.in
```kconfig
if BR2_PACKAGE_DIRECTFB
config BR2_PACKAGE_DFBSEE
	bool "DFBSee"
	help
	  DFBSee is an image viewer and video player, the current
	  version is a quick hack but nice though.
	  http://www.directfb.org/
endif

config BR2_PACKAGE_HOST_DIRECTFB
	bool
	default y if BR2_PACKAGE_DFBSEE
	default n
```

## buildroot/package/efl/Config.in
```kconfig
menuconfig BR2_PACKAGE_EFL
	bool "Enlightenment Foundation Libraries"
	depends on BR2_USE_WCHAR
	help
	  Enlightenment Foundation Libraries

	  http://enlightenment.org

if BR2_PACKAGE_EFL

source "buildroot/package/efl/expedite/Config.in"
source "buildroot/package/efl/libeina/Config.in"
source "buildroot/package/efl/libecore/Config.in"
source "buildroot/package/efl/libeet/Config.in"
source "buildroot/package/efl/libefreet/Config.in"
source "buildroot/package/efl/libeio/Config.in"
source "buildroot/package/efl/libevas/Config.in"
source "buildroot/package/efl/libevas-generic-loaders/Config.in"
source "buildroot/package/efl/libembryo/Config.in"
source "buildroot/package/efl/libedje/Config.in"
source "buildroot/package/efl/libethumb/Config.in"
source "buildroot/package/efl/libelementary/Config.in"
source "buildroot/package/efl/libedbus/Config.in"

endif # BR2_PACKAGE_EFL

comment "EFL needs a toolchain w/ wchar"
	depends on !BR2_USE_WCHAR
```

## buildroot/package/freescale-imx/Config.in
```kconfig
menu "Freescale i.MX libraries"
	depends on BR2_arm

source "buildroot/package/freescale-imx/imx-lib/Config.in"
source "buildroot/package/freescale-imx/firmware-imx/Config.in"
source "buildroot/package/freescale-imx/gpu-viv-bin-mx6q/Config.in"

endmenu
```

## buildroot/package/gstreamer/Config.in
```kconfig
# Gstreamer 0.10.x & Plugins
source "buildroot/package/gstreamer/gstreamer/Config.in"
source "buildroot/package/gstreamer/gst-plugins-base/Config.in"
source "buildroot/package/gstreamer/gst-plugins-good/Config.in"
source "buildroot/package/gstreamer/gst-plugins-bad/Config.in"
source "buildroot/package/gstreamer/gst-plugins-ugly/Config.in"
source "buildroot/package/gstreamer/gst-ffmpeg/Config.in"
source "buildroot/package/gstreamer/gst-dsp/Config.in"
source "buildroot/package/gstreamer/gst-fsl-plugins/Config.in"
source "buildroot/package/gstreamer/gst-omapfb/Config.in"
source "buildroot/package/gstreamer/gst-plugin-x170/Config.in"
```

## buildroot/package/gstreamer1/Config.in
```kconfig
# Gstreamer 1.x & Plugins
source "buildroot/package/gstreamer1/gstreamer1/Config.in"
source "buildroot/package/gstreamer1/gst1-plugins-base/Config.in"
source "buildroot/package/gstreamer1/gst1-plugins-good/Config.in"
source "buildroot/package/gstreamer1/gst1-plugins-bad/Config.in"
source "buildroot/package/gstreamer1/gst1-plugins-ugly/Config.in"
source "buildroot/package/gstreamer1/gst1-libav/Config.in"
```

## buildroot/package/gstreamer1/gst1-libav/Config.in
```kconfig
config BR2_PACKAGE_GST1_LIBAV
	bool "gst1-libav"
	depends on BR2_PACKAGE_GSTREAMER1
	select BR2_PACKAGE_GST1_PLUGINS_BASE
	help
	  GStreamer plugin (formerly gst-ffmpeg).

	  This package contains GStreamer plugins based on
	  the libav project.

	  http://gstreamer.freedesktop.org/
```

## kernel/arch/arm/mach-apollo/Kconfig
```kconfig
#
#    arch/arm/mach-imapx15/Kconfig
#		
#     Copyright (c) 2009~2014 ShangHai Infotm Ltd all rights reserved.
#	  Use of Infotm's code is governed by terms and conditions
#	  stated in the accompanying licensing statement. 
#	  Author:
#          ALex Zhang   <tao_zhang@infotm.com>
#	  Revision History: 
#		   ----------------
#		   1.1  16/09/2009  Alex Zhang   

 menu "APOLLO Machines"

 config MACH_APOLLO
    bool "APOLLO"
    select CPU_APOLLO
	select ARM_GIC
    help
      Say Y here if you are using the APOLLO

endmenu

config CPU_APOLLO
    bool
    depends on ARCH_APOLLO
    help
      Support for APOLLO Infotm Mobile CPU based systems.


config APOLLO_FPGA_PLATFORM
    bool "apollo fpga test"
    depends on ARCH_APOLLO
    default n
    help
       If you are operating on the FPGA platform, set Y here!

config FPGA_CPU_CLK
    int "FPGA cpu clock configure"
    depends on APOLLO_FPGA_PLATFORM
    default "40000000"

config FPGA_EXTEND_CLK
    int "FPGA externel clock configure"
    depends on APOLLO_FPGA_PLATFORM
    default "40000000"

config FPGA_UART_CLK
	int "FPGA uart clock configure"
	depends on APOLLO_FPGA_PLATFORM
	default "40000000"

config APOLLO_DMA
    bool
    depends on ARCH_APOLLO
    select PL330
    default y
    help
    apollo dma enable

config  FAKE_PM
        bool "Support for fake power manage"
        depends on ARCH_APOLLO
        default n
```

## kernel/arch/arm/mach-apollo3/Kconfig
```kconfig
#
#		
#     Copyright (c) 2009~2014 ShangHai Infotm Ltd all rights reserved.
#	  Use of Infotm's code is governed by terms and conditions
#	  stated in the accompanying licensing statement. 
#	  Author:
#          ALex Zhang   <tao_zhang@infotm.com>
#	  Revision History: 
#		   ----------------
#		   1.1  16/09/2009  Alex Zhang   

 menu "APOLLO3 Machines"

 config MACH_APOLLO3
    bool "Apollo3"
    select CPU_APOLLO3
	select ARM_GIC
    help
      Say Y here if you are using the APOLLO3

endmenu

config CPU_APOLLO3
    bool
    depends on ARCH_APOLLO3
    help
      Support for APOLLO3 Infotm Mobile CPU based systems.


config APOLLO3_FPGA_PLATFORM
    bool "APOLLO3 FPGA TEST"
    depends on ARCH_APOLLO3
    default n
    help
       If you are operating on the FPGA platform, set Y here!

config FPGA_CPU_CLK
    int "FPGA cpu clock configure"
    depends on APOLLO3_FPGA_PLATFORM
    default "40000000"

config FPGA_EXTEND_CLK
    int "FPGA externel clock configure"
    depends on APOLLO3_FPGA_PLATFORM
    default "40000000"

config FPGA_UART_CLK
	int "FPGA uart clock configure"
	depends on APOLLO3_FPGA_PLATFORM
	default "40000000"

config APOLLO3_DMA
    bool
    depends on ARCH_APOLLO3
    select PL330
    default y
    help
    apollo dma enable

config  FAKE_PM
        bool "Support for fake power manage"
        depends on ARCH_APOLLO3
        default n
```

## kernel/arch/arm/mach-coronampw/Kconfig
```kconfig
#
#		
#     Copyright (c) 2009~2014 ShangHai Infotm Ltd all rights reserved.
#	  Use of Infotm's code is governed by terms and conditions
#	  stated in the accompanying licensing statement. 
#	  Author:
#          ALex Zhang   <tao_zhang@infotm.com>
#	  Revision History: 
#		   ----------------
#		   1.1  16/09/2009  Alex Zhang   

 menu "CORONAMPW Machines"

 config MACH_CORONAMPW
    bool "Coronampw"
    select CPU_CORONAMPW
	select ARM_GIC
    help
      Say Y here if you are using the CORONAMPW

endmenu

config CPU_CORONAMPW
    bool
    depends on ARCH_CORONAMPW
    help
      Support for CORONAMPW Infotm Mobile CPU based systems.


config CORONAMPW_FPGA_PLATFORM
    bool "CORONAMPW FPGA TEST"
    depends on ARCH_CORONAMPW
    default n
    help
       If you are operating on the FPGA platform, set Y here!

config FPGA_CPU_CLK
    int "FPGA cpu clock configure"
    depends on CORONAMPW_FPGA_PLATFORM
    default "40000000"

config FPGA_EXTEND_CLK
    int "FPGA externel clock configure"
    depends on CORONAMPW_FPGA_PLATFORM
    default "40000000"

config FPGA_UART_CLK
	int "FPGA uart clock configure"
	depends on CORONAMPW_FPGA_PLATFORM
	default "40000000"

config CORONAMPW_DMA
    bool
    depends on ARCH_CORONAMPW
    select PL330
    default y
    help
    apollo dma enable

config  FAKE_PM
        bool "Support for fake power manage"
        depends on ARCH_CORONAMPW
        default n
```

## kernel/arch/arm/mach-imapx15/Kconfig
```kconfig
#
#    arch/arm/mach-imapx15/Kconfig
#		
#     Copyright (c) 2009~2014 ShangHai Infotm Ltd all rights reserved.
#	  Use of Infotm's code is governed by terms and conditions
#	  stated in the accompanying licensing statement. 
#	  Author:
#          ALex Zhang   <tao_zhang@infotm.com>
#	  Revision History: 
#		   ----------------
#		   1.1  16/09/2009  Alex Zhang   

 menu "IMAPX15 Machines"

 config MACH_IMAPX15
    bool "IMAPX15"
    select CPU_IMAPX15
	select ARM_GIC
    help
      Say Y here if you are using the IMAPX15

endmenu

config CPU_IMAPX15
    bool
    depends on ARCH_IMAPX15
    help
      Support for IMAPX15 Infotm Mobile CPU based systems.


config IMAPX15_FPGA_PLATFORM
    bool "imapx15 fpga test"
    depends on ARCH_IMAPX15
    default n
    help
       If you are operating on the FPGA platform, set Y here!

config FPGA_CPU_CLK
    int "FPGA cpu clock configure"
    depends on IMAPX15_FPGA_PLATFORM
    default "40000000"

config FPGA_EXTEND_CLK
    int "FPGA externel clock configure"
    depends on IMAPX15_FPGA_PLATFORM
    default "40000000"

config IMAPX15_DMA
    bool
    depends on ARCH_IMAPX15
    select PL330
    default y
    help
    imapx15 dma enable

config  FAKE_PM
        bool "Support for fake power manage"
        depends on ARCH_IMAPX15
        default n
```
