## kernel/arch/arm/mach-imapx910/Kconfig
```kconfig
#
#    arch/arm/mach-imapx910/Kconfig
#		
#     Copyright (c) 2009~2014 ShangHai Infotm Ltd all rights reserved.
#	  Use of Infotm's code is governed by terms and conditions
#	  stated in the accompanying licensing statement. 
#	  Author:
#          ALex Zhang   <tao_zhang@infotm.com>
#	  Revision History: 
#		   ----------------
#		   1.1  16/09/2009  Alex Zhang   

 menu "IMAPX910 Machines"

 config MACH_IMAPX910
    bool "IMAPX910"
    select CPU_IMAPX910
	select ARM_GIC
    help
      Say Y here if you are using the IMAPX910

endmenu

config CPU_IMAPX910
    bool
    depends on ARCH_IMAPX910
    help
      Support for IMAPX910 Infotm Mobile CPU based systems.


config IMAPX910_FPGA_PLATFORM
    bool "imapx910 fpga test"
    depends on ARCH_IMAPX910
    default n
    help
       If you are operating on the FPGA platform, set Y here!

config FPGA_CPU_CLK
    int "FPGA cpu clock configure"
    depends on IMAPX910_FPGA_PLATFORM
    default "40000000"

config FPGA_EXTEND_CLK
    int "FPGA externel clock configure"
    depends on IMAPX910_FPGA_PLATFORM
    default "40000000"

config IMAPX910_DMA
    bool
    depends on ARCH_IMAPX910
    select PL330
    default y
    help
    imapx910 dma enable

config  FAKE_PM
        bool "Support for fake power manage"
        depends on ARCH_IMAPX910
        default n
```

## kernel/arch/arm/mach-q3f/Kconfig
```kconfig
#
#		
#     Copyright (c) 2009~2014 ShangHai Infotm Ltd all rights reserved.
#	  Use of Infotm's code is governed by terms and conditions
#	  stated in the accompanying licensing statement. 
#	  Author:
#          ALex Zhang   <tao_zhang@infotm.com>
#	  Revision History: 
#		   ----------------
#		   1.1  16/09/2009  Alex Zhang   

 menu "Q3F Machines"

 config MACH_Q3F
    bool "Apollo2-Q3F"
    select CPU_Q3F
	select ARM_GIC
    help
      Say Y here if you are using the Q3F

endmenu

config CPU_Q3F
    bool
    depends on ARCH_Q3F
    help
      Support for Q3F Infotm Mobile CPU based systems.


config Q3F_FPGA_PLATFORM
    bool "Q3F FPGA TEST"
    depends on ARCH_Q3F
    default n
    help
       If you are operating on the FPGA platform, set Y here!

config FPGA_CPU_CLK
    int "FPGA cpu clock configure"
    depends on Q3F_FPGA_PLATFORM
    default "40000000"

config FPGA_EXTEND_CLK
    int "FPGA externel clock configure"
    depends on Q3F_FPGA_PLATFORM
    default "40000000"

config FPGA_UART_CLK
	int "FPGA uart clock configure"
	depends on Q3F_FPGA_PLATFORM
	default "40000000"

config Q3F_DMA
    bool
    depends on ARCH_Q3F
    select PL330
    default y
    help
    apollo dma enable

config  FAKE_PM
        bool "Support for fake power manage"
        depends on ARCH_Q3F
        default n
```

## kernel/drivers/infotm/Kconfig
```kconfig
menuconfig INFOTM_SPECIAL
	bool "InfoTM special files and drivers"
	default y
	select GENERIC_ALLOCATOR
	help
	  InfoTM special files and drivers support

if INFOTM_SPECIAL

source "drivers/infotm/imapx910/Kconfig"
source "drivers/infotm/imapx15/Kconfig"
source "drivers/infotm/apollo/Kconfig"
source "drivers/infotm/apollo3/Kconfig"
source "drivers/infotm/coronampw/Kconfig"
source "drivers/infotm/q3f/Kconfig"
source "drivers/infotm/common/Kconfig"

endif
```

## kernel/drivers/infotm/apollo/Kconfig
```kconfig
 menuconfig INFOTM_DRV_APOLLO                         
     bool "Infotm APOLLO Series Support"           
     depends on ARCH_APOLLO && INFOTM_SPECIAL      
     help                                            
         Infotm APOLLO Series support              
                                                     
 if INFOTM_DRV_APOLLO                                 
source "drivers/infotm/apollo/clk/Kconfig"
source "drivers/infotm/apollo/dpmu/Kconfig"
source "drivers/infotm/apollo/gpio/Kconfig"
source "drivers/infotm/apollo/input/Kconfig"
source "drivers/infotm/apollo/display/Kconfig"
source "drivers/infotm/apollo/emif/Kconfig"
source "drivers/infotm/apollo/mfd/Kconfig"
source "drivers/infotm/apollo/regulator/Kconfig"
source "drivers/infotm/apollo/ispost/Kconfig"
source "drivers/infotm/apollo/power_domain/Kconfig"
 endif                                               
```

## kernel/drivers/infotm/apollo/clk/Kconfig
```kconfig
 #                                                 
 #  Clock device configuration                     
 #                                                 
 #                                                 
menuconfig APOLLO_CLK                           
        bool "APOLLO clock driver support"
		depends on COMMON_CLK
        default n                                  
        help                                       
               Infotm input device driver suport   
```

## kernel/drivers/infotm/apollo/display/Kconfig
```kconfig
menuconfig INFOTM_DISPLAY
        bool "Infotm display support"
        default y
	select FB_CFB_FILLRECT
        select FB_CFB_COPYAREA
        select FB_CFB_IMAGEBLIT
	select FB_SYS_FILLRECT
        select FB_SYS_COPYAREA
        select FB_SYS_IMAGEBLIT
	select FB_SYS_FOPS
        help
          This enables support for the Infotm display driver.

if INFOTM_DISPLAY

config DISPLAY_IMAPX
       bool "iMAPx display driver fdasffsdfasd"
           default y
       help
         This enables support for the iMAPx series display driver.


choice LCD_MODULE_SUPPORT
    bool "LCD module support"
    default LCD_SPI_ILI8961

    comment "must one lcd selected"
    config LCD_SPI_OTA5182A
        tristate "ota5182 lcd driver(LCD module TXDT200LER)"
        depends on LCD_SPI 
      #  default y
       help
          This enables support ota5182a lcd driver

    config LCD_SPI_ILI8961
        tristate "ili8961 lcd driver support" 
        depends on LCD_SPI 
       # default n
       help
          This enables support ota5182a lcd driver

	config LCD_SPI_ILI9806S
        tristate "ili9806s lcd driver support" 
        depends on LCD_SPI 
       # default n
       help
          This enables support ota5182a lcd driver

    config LCD_I2C_GM0500400
        tristate "GM0500400 lcd module support" 
      #  default y
       help
          This enables support GM0500400 lcd module

endchoice
endif
```
