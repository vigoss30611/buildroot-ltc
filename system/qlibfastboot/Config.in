## system/qlibfastboot/Config.in
```kconfig
config BR2_PACKAGE_QLIBFASTBOOT
	bool "qlibfastboot"
	help 
	  fastboot(gadget fastboot) device-side fastbootd 
```

## system/qlibmediautils/Config.in
```kconfig
config BR2_PACKAGE_QLIBMEDIAUTILS
	bool "qlibmediautils"
    default n
	help
	  qlibmediautils deal with QSDK media issues.

if BR2_PACKAGE_QLIBMEDIAUTILS
    menu "Options"
        config CONFIG_QLIBMEDIAUTILS_CALIBRATION
            bool "jpeg calibration"
            default n
            select BR2_PACKAGE_LIBEXIF
            help
                support jpeg calibration by exif standard.

        config CONFIG_QLIBMEDIAUTILS_SWSCALE
            bool "sw scale"
            default n
            select BR2_PACKAGE_LIBFFMPEG
            select BR2_PACKAGE_LIBFFMPEG_AVFILTER
            select BR2_PACKAGE_LIBFFMPEG_AVFILTER_SCALE
            select BR2_PACKAGE_LIBFFMPEG_SWSCALE
            help
                support software scale.

        config CONFIG_QLIBMEDIAUTILS_SWCROP
            bool "sw crop"
            default n
            select BR2_PACKAGE_LIBFFMPEG
            select BR2_PACKAGE_LIBFFMPEG_AVFILTER
            select BR2_PACKAGE_LIBFFMPEG_AVFILTER_CROP
            help
                support software filter crop.

        config CONFIG_QLIBMEDIAUTILS_TESTING
            bool "install testing script"
            depends on CONFIG_QLIBMEDIAUTILS_CALIBRATION
            depends on CONFIG_QLIBMEDIAUTILS_SWSCALE
            depends on CONFIG_QLIBMEDIAUTILS_SWCROP
            default n
            help
                build & install test tools
    endmenu
endif
```

## system/qlibsensors/Config.in
```kconfig
config BR2_PACKAGE_QLIBSENSORS
	bool "qlibsensors"
	help
		Provide API for many sensors

if BR2_PACKAGE_QLIBSENSORS
	config  BR2_PACKAGE_LIGHT_SENSOR
		bool "Light Sensor"
		default n
	if BR2_PACKAGE_LIGHT_SENSOR
		config BR2_PACKAGE_LIGHT_SENSOR_DEV
		string "Specify device path"
		default "/sys/devices/platform/pt550/voltage"
	endif

	config  BR2_PACKAGE_GPS
		bool "GPS"
		default n
	if BR2_PACKAGE_GPS
		config BR2_PACKAGE_GPS_TTY
		string "Specify TTY"
		default "/dev/ttyUSB0"

		config BR2_PACKAGE_GPS_TTY_SPEED
		string "Baudrate"
		default "115200"

		config BR2_PACKAGE_GPS_TTY_DATA
		string "Data"
		default "8"

		choice
			prompt "Parity"
			default BR2_PACKAGE_GPS_TTY_PAR_NONE
			
			config BR2_PACKAGE_GPS_TTY_PAR_NONE
			bool "None"
			config BR2_PACKAGE_GPS_TTY_PAR_EVEN
			bool "Even"
			config BR2_PACKAGE_GPS_TTY_PAR_ODD
			bool "Odd"
		endchoice

		config BR2_PACKAGE_GPS_TTY_STOP
		string "Stop bit"
		default "1"
	endif
endif
```

## system/qlibsmartrc/Config.in
```kconfig
config BR2_PACKAGE_QLIBSMARTRC
	bool "Smart RC"
    default y
	help
		Smart RC

if BR2_PACKAGE_QLIBSMARTRC


endif
```

## system/qlibsys/Config.in
```kconfig
config BR2_PACKAGE_QLIBSYS
	bool "qlibsys"
	help
	  system interface lib

	  http://www.infotm.com/
if BR2_PACKAGE_QLIBSYS
menu "options"
	config  BR2_PACKAGE_QLIBSYS_INSTALL_SHARED
		bool "Install Shared"
		default y
		help
	  		install shared library into target dir	
endmenu

endif
```

## system/qlibupgrade/Config.in
```kconfig
config BR2_PACKAGE_QLIBUPGRADE
	bool "qlibupgrade"
	help
		upgrade tool for QSDK

if BR2_PACKAGE_QLIBUPGRADE
	config  BR2_PACKAGE_BINUPGRADE
		bool "Install common upgrade app"
		default n
		help
	  		Install common upgrade app
endif
```

## system/qlibvplay/Config.in
```kconfig
config BR2_PACKAGE_QLIBVPLAY
	bool "qlibvplay"
	help
		Qlibvplay deal with QSDK media issues
if BR2_PACKAGE_QLIBVPLAY
menu "Options"
	config  BR2_PACKAGE_QLIBVPLAY_GDBDEBUG
		bool "Gdb Debug"
		default n
		help
	  		enable gdb debug support
	config  BR2_PACKAGE_QLIBVPLAY_TEST_UTILS
		bool "Test Utils"
		default n
		help
	  		enable test utils install to system
	config  BR2_PACKAGE_QLIBVPLAY_FRAGMENTED
		bool "Fragemented File"
		default n
		help
	  		enable fragmented mp4/mov support
	config  BR2_PACKAGE_QLIBVPLAY_RECORDER_CACHE_TIME
		string "Recorder Cache Time"
		default 3
		help
	  		recorder normal mode cache time
	config  BR2_PACKAGE_QLIBVPLAY_PLAYER_CACHE_TIME
		string "Player Cache Time"
		default 1
		help
	  		Player cache time
	config  BR2_PACKAGE_QLIBVPLAY_RECORDER_SPS_MODIFY
		bool "Recorder sps modify"
		default y
		help
	  		Recorder h264 sps modify support
choice
	prompt "Log Level"
	default BR2_PACKAGE_QLIBVPLAY_LOGLEVEL_TRC
	help
	  Select the WiFi module you wish to use.

config BR2_PACKAGE_QLIBVPLAY_LOGLEVEL_TRC
	bool "TRC"
	help
	  log level trace.


config BR2_PACKAGE_QLIBVPLAY_LOGLEVEL_DBG
	bool "DEBUG"
	help
	  log level debug.

config BR2_PACKAGE_QLIBVPLAY_LOGLEVEL_INFO
	bool "INFO"
	help
	  log level info.

config BR2_PACKAGE_QLIBVPLAY_LOGLEVEL_WARN
	bool "WARN"
	help
	  log level warning.

config BR2_PACKAGE_QLIBVPLAY_LOGLEVEL_ERR
	bool "ERROR"
	help
	  log level error.

endchoice

config BR2_PACKAGE_QLIBVPLAY_LOGLEVEL
	string
	default 1         if BR2_PACKAGE_QLIBVPLAY_LOGLEVEL_TRC
	default 2         if BR2_PACKAGE_QLIBVPLAY_LOGLEVEL_DBG
	default 3         if BR2_PACKAGE_QLIBVPLAY_LOGLEVEL_INFO
	default 4         if BR2_PACKAGE_QLIBVPLAY_LOGLEVEL_WARN
	default 5         if BR2_PACKAGE_QLIBVPLAY_LOGLEVEL_ERR
endmenu
endif
```

## system/qlibwifi/Config.in
```kconfig
config BR2_PACKAGE_QLIBWIFI
	bool "qlibwifi"
	help
		QSDK Wi-Fi manager, HAL and APIs


if BR2_PACKAGE_QLIBWIFI
choice
	prompt "Wi-Fi Module"
	default BR2_WIFI_HARDWARE_MODULE_B
	help
	  Select the WiFi module you wish to use.

config BR2_WIFI_HARDWARE_MODULE_B
	bool "bcm6210"
	help
	  BCM6210 hardware module name.

config BR2_WIFI_HARDWARE_MODULE_B1
	bool "bcm6212"
	help
	  BCM6212 hardware module name.

config BR2_WIFI_HARDWARE_MODULE_B2
	bool "bcm6214"
	help
	  BCM6214 hardware module name.

config BR2_WIFI_HARDWARE_MODULE_B3
	bool "bcm6236"
	help
	  BCM6236 hardware module name.	  	  

config BR2_WIFI_HARDWARE_MODULE_R
	bool "rtl8188"
	help
	  RTL8188 hardware module name.

config BR2_WIFI_HARDWARE_MODULE_R1
	bool "rtl8189"
	help
	  RTL8189 hardware module name.

config BR2_PACKAGE_QLIBWIFI_NONE
	bool "none"
	help
	  No hardware module select
endchoice

config BR2_WIFI_HARDWARE_MODULE
        string
        default "bcm6210"        if BR2_WIFI_HARDWARE_MODULE_B
        default "bcm6212"        if BR2_WIFI_HARDWARE_MODULE_B1
        default "bcm6214"        if BR2_WIFI_HARDWARE_MODULE_B2
        default "bcm6236"        if BR2_WIFI_HARDWARE_MODULE_B3        
        default "rtl8188"        if BR2_WIFI_HARDWARE_MODULE_R
        default "rtl8189"        if BR2_WIFI_HARDWARE_MODULE_R1

choice
	prompt "Wi-Fi Mode"
	default BR2_WIFI_STA_AND_AP_MODE
	help
	  Select Wi-Fi mode as you wish.

config BR2_WIFI_STA_AND_AP_MODE
    bool "STA and AP"
	help
    Wi-Fi STA and AP mode.

config BR2_WIFI_STA_MODE
	bool "STA"
	help
    Wi-Fi STA mode.

config BR2_WIFI_AP_MODE
	bool "AP"
	help
    Wi-Fi AP mode.
endchoice

config BR2_WIFI_MODE
        string
        default "both"        if BR2_WIFI_STA_AND_AP_MODE
        default "sta"        if BR2_WIFI_STA_MODE
        default "ap"        if BR2_WIFI_AP_MODE
 
endif
```

## system/qm-hal/Config.in
```kconfig
if BR2_PACKAGE_QM
	
config BR2_PACKAGE_QM_HAL
	bool "qm-hal"
	help
	  Build QM_HAL

if BR2_PACKAGE_QM_HAL 
	config  BR2_QM_HAL_QIPC_38F
		bool "qm hal qipc 38f support"
		default n
		help
	  		enable qipc_38f qm hal

	config  BR2_QM_HAL_QIPC_38I
		bool "qm hal qipc 38i support"
		default n
		help
	  		enable qipc_38i qm hal

	config  BR2_QM_HAL_QIPC_Q3520E_SINGLE
		bool "qm hal qipc q3520e single support"
		default n
		help
	  		enable qipc_q3520e qm hal
	
	config BR2_QM_HAL_SYS_DUMP
		bool "qm hal sys no special chip support"
		default n
		help
				enable dump qm hal
endif

endif
```

## system/qm/Config.in
```kconfig
config BR2_PACKAGE_QM
	bool "qm"
	help
	  Build QM



if BR2_PACKAGE_QM 
	config  BR2_QM_ENCODE_CONTROL_ENABLE
		bool "encode control enable"
		default y
		help
	  		enable qm encode control

endif
```

## system/testing/Config.in
```kconfig
config BR2_PACKAGE_TESTING
	bool "Testing menu"

	help
		vbctrl
		http://www.infotm.com/

if BR2_PACKAGE_TESTING 
	config  BR2_PACKAGE_TESTING_GPIO
		bool "Testing gpio"
		default y
		help
	  		install shared library into target dir
	config  BR2_PACKAGE_TESTING_CCF
		bool "Testing ccf"
		default y
		help
	  		install shared library into target dir
	config  BR2_PACKAGE_TESTING_AUTO_DELAYLINE_TEST
		bool "Testing delayline"
		default y
		help
	  		install shared library into target dir
	config  BR2_PACKAGE_TESTING_VBCTRL
		bool "Testing vbctrl"
		default y
		help
	  		install shared library into target dir	
	config  BR2_PACKAGE_TESTING_ABCTRL
		bool "Testing abctrl"
		default y
		help
	  		install shared library into target dir
	config  BR2_PACKAGE_TESTING_TESTBENCH_H2V1
		bool "Testing testbench_h2v1"
		default n
		help
	  		install shared library into target dir	
	config  BR2_PACKAGE_TESTING_TESTBENCH_G2V1
		bool "Testing testbench_g2v1"
		default n
		help
	  		install shared library into target dir	
	config  BR2_PACKAGE_TESTING_TESTBENCH_H1V6
		bool "Testing testbench_h1v6"
		default n
		help
	  		install shared library into target dir
	config  BR2_PACKAGE_TESTING_TESTBENCH_JENC
		bool "Testing testbench_jenc"
		default n
		help
	  		install shared library into target dir
	config  BR2_PACKAGE_TESTING_TESTBENCH_G1V6
		bool "Testing testbench_g1v6"
		default n
		help
	  		install shared library into target dir
	config  BR2_PACKAGE_TESTING_DISPLAY2
		bool "Testing display2"
		default y
		help
	  		install shared library into target dir
	config  BR2_PACKAGE_TESTING_WATCHDOG
		bool "Testing Watchdog Timer"
		default y
		help
	  		install shared library into target dir
	config  BR2_PACKAGE_TESTING_MMC
		bool "Testing SD/MMC card"
		default y
	source "$BR2_EXTERNAL/testing/misc/Config.in"
	config  BR2_PACKAGE_TESTING_MORE_CUSTOM
		bool "more testing, will add soon"
		default y
		help
	  		install shared library into target dir

endif
```

## system/testing/misc/Config.in
```kconfig
config BR2_PACKAGE_TESTING_MISC
	bool "Testing misc menu"

	help
		misc menu
		http://www.infotm.com/

if BR2_PACKAGE_TESTING_MISC 
	config  BR2_PACKAGE_TESTING_MUXING
		bool "Testing misc muxing"
		default y
		help
	  		install shared library into target dir	
	config  BR2_PACKAGE_TESTING_MISC_MORE_CUSTOM
		bool "more testing misc options, will add soon"
		default n
		help
	  		install shared library into target dir	

endif
```

## system/testing/testbench_g2v1/Config.in
```kconfig
config BR2_PACKAGE_TESTBENCH_HEVC_DEC
	bool "testbench_hevc_dec"

	help
		foo library
		http://www.infotm.com/

if BR2_PACKAGE_TESTBENCH_HEVC_DEC
menu "options"
	config  BR2_PACKAGE_TESTBENCH_HEVC_DEC_INSTALL_SHARED
		bool "Install Shared"
		default y
		help
	  		install shared library into target dir	
endmenu

endif
```
