## system/hlibh2v4/Config.in
```kconfig
config BR2_PACKAGE_HLIBH2V4
	bool "libh2v4"

	help
		libh2v4
		http://www.infotm.com/

if BR2_PACKAGE_HLIBH2V4
menu "Options"
	config  BR2_PACKAGE_HLIBH2V4_GDBDEBUG
		bool "h2 gdb debug"
		default n
		help
	  		gdb debug support
	config  BR2_PACKAGE_HLIBH2V4_TESTBENCH
		bool "h2 testbench"
		default n
		help
	  		enable h2v4 testbench
	config  BR2_PACKAGE_HLIBH2V4_POLL
		bool "h2 ewl polling mode"
		default n
		help
	  		enable h2v4 ewl poll mode
endmenu

endif
```

## system/hlibhid/Config.in
```kconfig
config BR2_PACKAGE_HLIBHID
	bool "hlibhid"
	help 
	  hid(gadget hid) device-side hid library
```

## system/hlibispostv1/Config.in
```kconfig
config BR2_PACKAGE_ISPOST
	bool "ispost"
	help
	  Fix me

	  http://www.infotm.com/
```

## system/hlibispostv2/Config.in
```kconfig
config BR2_PACKAGE_ISPOSTV2
	bool "hlibispostv2"
	help
	  Fix me

	  http://www.infotm.com/
```

## system/hlibispv2500/Config.in
```kconfig
config BR2_PACKAGE_LIBISPV2500
	bool "hlibispv2500"
	default y
	help
		This is for ISP

if BR2_PACKAGE_LIBISPV2500


config BR2_PACKAGE_LIBISPV2500_MNEON
	bool "math neon use"
	default n
	help 
		Whether use math neon libaray

config BR2_PACKAGE_LIBISPV2500_Q360
	bool "q360 project"
	default n
	help 
		Whether is Q360 project
endif
```

## system/hlibispv2505/Config.in
```kconfig
config BR2_PACKAGE_LIBISPV2505
	bool "hlibispv2505"
	default y
	help
		This is for ISP

if BR2_PACKAGE_LIBISPV2505

config BR2_PACKAGE_LIBISPV2505_LANCHOU
        bool "lanchou project"
        default n
        help
                Whether is lanchou project

config BR2_PACKAGE_LIBISPV2505_MNEON
	bool "math neon use"
	default n
	help
		Whether use math neon libaray

config BR2_PACKAGE_LIBISPV2505_HW_AWB
        bool "Hardware AWB Method"
        default n
        help
                Whether use hardware awb

endif
```

## system/hlibitems/Config.in
```kconfig
config BR2_PACKAGE_HLIBITEMS
	bool "hlibitems"
	help
	  Osa communication lib

	  http://www.infotm.com/
if BR2_PACKAGE_HLIBITEMS 
menu "options"
	config  BR2_PACKAGE_HLIBITEMS_INSTALL_SHARED
		bool "Install Shared"
		default y
		help
	  		install shared library into target dir	
endmenu

endif
```

## system/hlibjenc/Config.in
```kconfig
config BR2_PACKAGE_HLIBJENC
	bool "libjenc"
    default n
	help
		libjenc library
```

## system/hlibvcp7g/Config.in
```kconfig
config BR2_PACKAGE_HLIBVCP7G
	bool "hlibvcp7g"
	default y
	help
	  hlibvcp7g 

	  http://www.infotm.com/

if BR2_PACKAGE_HLIBVCP7G
menu "Options"
	config BR2_PACKAGE_HLIBVCP7G_DSP_SUPPORT
		bool "enable dsp-lib support"
		depends on BR2_PACKAGE_HLIBDSP && BR2_PACKAGE_HLIBDSP_AEC
		default n
		help
			say y if you want to use DSP library for AEC

	config BR2_PACKAGE_HLIBVCP7G_ARM_SUPPORT
		bool "enable arm-lib support(not recommanded)"
		default n
		help
			say y if you want to use ARM library for AEC
endmenu
endif
```

## system/hlibvideodebug/Config.in
```kconfig
config BR2_PACKAGE_HLIBVIDEODEBUG
	bool "hlibvideodebug"
	help
		video debug tools library
```

## system/iuw/Config.in
```kconfig
config BR2_PACKAGE_HOST_IUW
	bool "InfoTM Update Wrapper (IUW)"
	help
	  Generate InfoTM Secure Image format(.isi) images
	  and InfoTM Update expreSS package.
```

## system/libcodecs/Config.in
```kconfig
config BR2_PACKAGE_LIBCODECS
	bool "libcodecs"
	help 
	  codec enable you to encode or decode audio file

if BR2_PACKAGE_LIBCODECS
menu "Options"
	config BR2_PACKAGE_LIBCODECS_DSP_SUPPORT
		bool "dsp enable"
		default n
		help
			say y if you want to support dsp encode for aac
endmenu
endif
```

## system/libdemux/Config.in
```kconfig
config BR2_PACKAGE_LIBDEMUX
	bool "libdemux"
	help
	  demux lib

	  http://www.infotm.com/
```

## system/libfaac/Config.in
```kconfig
config BR2_PACKAGE_LIBFAAC
	bool "libfaac"
	help
	  Osa communication lib

	  http://www.infotm.com/
if BR2_PACKAGE_LIBFAAC 
menu "options"
	config  BR2_PACKAGE_LIBFAAC_INSTALL_SHARED
		bool "Install Shared"
		default y
		help
	  		install shared library into target dir	
endmenu

endif
```

## system/libfaad/Config.in
```kconfig
config BR2_PACKAGE_LIBFAAD
	bool "libfaad"
	help
	  Osa communication lib

	  http://www.infotm.com/
if BR2_PACKAGE_LIBFAAD 
menu "options"
	config  BR2_PACKAGE_LIBFAAD_INSTALL_SHARED
		bool "Install Shared"
		default y
		help
	  		install shared library into target dir	
endmenu

endif
```

## system/libffmpeg/Config.in
```kconfig
config BR2_PACKAGE_LIBFFMPEG
	bool "libffmpeg"
        default y
	help
	  ffmpeg enable you need module

if BR2_PACKAGE_LIBFFMPEG
menu "Options"

	config BR2_PACKAGE_LIBFFMPEG_ENCODER
		bool "encoder enable"
		default y
		help
			say y if you want to enable encoder
	if BR2_PACKAGE_LIBFFMPEG_ENCODER
		config BR2_PACKAGE_LIBFFMPEG_ENCODER_LIBFDK_AAC
			bool "libfdk-aac"
			default n
			select BR2_PACKAGE_FDK_AAC
			help
				say y if you want to support libfdk-aac
		config BR2_PACKAGE_LIBFFMPEG_ENCODER_AAC
			bool "aac"
			default n
			help
				say y if you want to support aac
		config BR2_PACKAGE_LIBFFMPEG_ENCODER_AC3
			bool "ac3"
			default n
			help
				say y if you want to support ac3
		config BR2_PACKAGE_LIBFFMPEG_ENCODER_PCM_ALAW
			bool "g711"
			default n
			help
				say y if you want to support g711
		config BR2_PACKAGE_LIBFFMPEG_ENCODER_PCM_G726
			bool "g726"
			default n
			help
				say y if you want to support g726
		config BR2_PACKAGE_LIBFFMPEG_ENCODER_MJPEG
			bool "mjpeg"
			default n
			help
				say y if you want to support mjpeg
		config BR2_PACKAGE_LIBFFMPEG_ENCODER_H264
			bool "h264, not support"
			default n
			help
				say y if you want to support h264
		config BR2_PACKAGE_LIBFFMPEG_ENCODER_HEVC
			bool "hevc, not support"
			default n
			help
				say y if you want to support hevc
	endif
	config BR2_PACKAGE_LIBFFMPEG_DECODER
		bool "decoder enable"
		default y
		help
			say y if you want to enable decoder
	if BR2_PACKAGE_LIBFFMPEG_DECODER
		config BR2_PACKAGE_LIBFFMPEG_DECODER_LIBFDK_AAC
			bool "libfdk-aac"
			default n
			select BR2_PACKAGE_FDK_AAC
			help
				say y if you want to support libfdk-aac
		config BR2_PACKAGE_LIBFFMPEG_DECODER_AAC
			bool "aac"
			default n
			help
				say y if you want to support ffmpeg aac decoder
		config BR2_PACKAGE_LIBFFMPEG_DECODER_AC3
			bool "ac3"
			default n
			help
				say y if you want to support libfdk-aac
		config BR2_PACKAGE_LIBFFMPEG_DECODER_PCM_ALAW
			bool "g711"
			default n
			help
				say y if you want to support g711
		config BR2_PACKAGE_LIBFFMPEG_DECODER_MJPEG
			bool "mjpeg"
			default n
			help
				say y if you want to support mjpeg
		config BR2_PACKAGE_LIBFFMPEG_DECODER_H264
			bool "h264"
			default n
			help
				say y if you want to support h264
		config BR2_PACKAGE_LIBFFMPEG_DECODER_HEVC
			bool "hevc"
			default n
			help
				say y if you want to support hevc
		config BR2_PACKAGE_LIBFFMPEG_DECODER_MP3
			bool "mp3"
			default y
			help
				say y if you want to support mp3
	endif
	config BR2_PACKAGE_LIBFFMPEG_PARSER
		bool "parser enable"
		default y
		help
			say y if you want to enable parser
	if BR2_PACKAGE_LIBFFMPEG_PARSER
		config BR2_PACKAGE_LIBFFMPEG_PARSER_AAC
			bool "aac"
			default n
			help
				say y if you want to support parser aac
		config BR2_PACKAGE_LIBFFMPEG_PARSER_MJPEG
			bool "mjpeg"
			default n
			help
				say y if you want to support ffmpeg parser mjpeg
		config BR2_PACKAGE_LIBFFMPEG_PARSER_H264
			bool "h264"
			default n
			help
				say y if you want to support parser
		config BR2_PACKAGE_LIBFFMPEG_PARSER_HEVC
			bool "hevc"
			default n
			help
				say y if you want to support ffmpeg parser hevc


	endif


	config BR2_PACKAGE_LIBFFMPEG_MUXER
		bool "muxer enable"
		default n
		help
			say y if you want to support muxer

	if BR2_PACKAGE_LIBFFMPEG_MUXER
		config BR2_PACKAGE_LIBFFMPEG_MUXER_MP4_MOV
			bool "mp4/mov"
			default n
			help
				say y if you want to enable muxer
		config BR2_PACKAGE_LIBFFMPEG_MUXER_MKV
			bool "mkv"
			default n
			help
				say y if you want to enable muxer matroska
		config BR2_PACKAGE_LIBFFMPEG_MUXER_MJPEG
			bool "mjpeg"
			default n
			help
				say y if you want to enable muxer mjpeg
	endif

	config BR2_PACKAGE_LIBFFMPEG_DEMUXER
		bool "demuxer enable"
		default n
		help
			say y if you want to enable demuxer
	if BR2_PACKAGE_LIBFFMPEG_DEMUXER
		config BR2_PACKAGE_LIBFFMPEG_DEMUXER_MP4_MOV
			bool "mp4/mov"
			default y
			help
				say y if you want to enable demuxer  mp4/mov
		config BR2_PACKAGE_LIBFFMPEG_DEMUXER_MKV
			bool "mkv"
			default y
			help
				say y if you want to enable demuxer matroska
		config BR2_PACKAGE_LIBFFMPEG_DEMUXER_WAV
			bool "wav"
			default n
			help
			say y if you want to enable demuxer wav
		config BR2_PACKAGE_LIBFFMPEG_DEMUXER_MP3
			bool "mp3"
			default y
			help
				say y if you want to enable demuxer mp3
		config BR2_PACKAGE_LIBFFMPEG_DEMUXER_MJPEG
			bool "mjpeg"
			default n
			help
				say y if you want to enable demuxer mjpeg
	endif

	config BR2_PACKAGE_LIBFFMPEG_BSF_FILTER
		bool "bsf filter enable"
		default y
		help
			say y if you want to enable bsf

	if BR2_PACKAGE_LIBFFMPEG_BSF_FILTER
		config BR2_PACKAGE_LIBFFMPEG_BSF_FILTER_H264_MP4TOANNEXB
			bool "h264_mp4toannexb"
			default n
			help
				The default option for h264_mp4toannexb module
		config BR2_PACKAGE_LIBFFMPEG_BSF_FILTER_HEVC_MP4TOANNEXB
			bool "hevc_mp4toannexb"
			default n
			help
				The default option for hevc_mp4toannexab bsf filter module
		config BR2_PACKAGE_LIBFFMPEG_BSF_FILTER_AAC_ADTSTOASC
			bool "aac_adtstoasc"
			default n
			help
				The default option for aac_adtstoasc module
		config BR2_PACKAGE_LIBFFMPEG_BSF_FILTER_MJPEG2JPEG
			bool "mjpeg2jpeg"
			default n
			help
				The default option for bsf mjeg2jpeg module
	endif
	config BR2_PACKAGE_LIBFFMPEG_AVFILTER
		bool "avfilter enable"
		default n
		help
			say y if you want to enable demuxer
	if BR2_PACKAGE_LIBFFMPEG_AVFILTER
		config BR2_PACKAGE_LIBFFMPEG_AVFILTER_CROP
			bool "crop"
			default n
			help
				crop
		config BR2_PACKAGE_LIBFFMPEG_AVFILTER_SCALE
			bool "scale"
			default n
			help
				scale
	endif
	config BR2_PACKAGE_LIBFFMPEG_SWRESAMPLE
		bool "swresample enable"
		default n
		help
			say n if you want to enable ffmpeg tools
	config BR2_PACKAGE_LIBFFMPEG_SWSCALE
		bool "swscale enable"
		default n
		help
			say n if you want to enable ffmpeg tools

	config BR2_PACKAGE_LIBFFMPEG_PROTOCOL
		bool "protocol enable"
		default y
		help
			say y if you want to enable protocol
	if BR2_PACKAGE_LIBFFMPEG_PROTOCOL
		config BR2_PACKAGE_LIBFFMPEG_PROTOCOL_HTTP
			bool "http"
			default y
			help
				http
	endif

	config BR2_PACKAGE_LIBFFMPEG_PROGRAMES
		bool "ffmpeg tools enable"
		default n
		help
			say n if you want to enable ffmpeg tools
	if BR2_PACKAGE_LIBFFMPEG_PROGRAMES
		config BR2_PACKAGE_LIBFFMPEG_FFMPEG
			bool "ffmpeg"
			select BR2_PACKAGE_LIBFFMPEG_SWRESAMPLE
			select BR2_PACKAGE_LIBFFMPEG_SWSCALE
			default n
			help
				say n if you want to enable ffmpeg tools
		config BR2_PACKAGE_LIBFFMPEG_FFPROBE
			bool "ffprobe enable"
			default n
			help
				say n if you want to enable ffprobe tools
	endif

endmenu
endif
```

## system/libfreetype/Config.in
```kconfig
config BR2_PACKAGE_LIBFREETYPE
	bool "libfreetype"
	depends on BR2_ENABLE_FREETYPE
	help
	  a free, high-quality and portable font engine.

	  http://www.freetype.org/
```

## system/libgridtools/Config.in
```kconfig
config BR2_PACKAGE_LIBGRIDTOOLS
    bool "libgridtools"
    default n
    help
        fisheye calibration and generate grid data.
if  BR2_PACKAGE_LIBGRIDTOOLS
    config BR2_PACKAGE_LIBGRIDTOOLS_SHARED
        bool "enable shared"
        default n
        help 
            fisheye shared library enable
endif
```

## system/libh264bitstream/Config.in
```kconfig
config BR2_PACKAGE_LIBH264BITSTREAM
	bool "h264bitstream"
    default n
	help
		h264 bit stream file ,can parse and gen h264 nalu
```

## system/libminigui/Config.in
```kconfig
config BR2_PACKAGE_LIBMINIGUI
	bool "libmingui"
	default n
	help
	  Osa communication lib

	  http://www.infotm.com/osa/

if BR2_PACKAGE_LIGLIBMINIGUI 
menu "Install Options"
	config  BR2_PACKAGE_LIGLIBMINIGUI_INSTALL_SHARED
		bool "Install Shared"
		default y
		help
	  		install shared library into target dir
endmenu
endif
```

## system/libmneon/Config.in
```kconfig
config BR2_PACKAGE_LIBMNEON
	bool "libmneon"

	help
		libmneon library
		http://www.infotm.com/

if BR2_PACKAGE_LIBMNEON
menu "options"
	config  BR2_PACKAGE_LIBMNEON_INSTALL_SHARED
		bool "Install Shared"
		default y
		help
	  		install shared library into target dir
endmenu

endif
```

## system/librtsp/Config.in
```kconfig
config BR2_PACKAGE_LIBRTSP
	bool "librtsp"
	help
	  rtsp server lib

	  http://www.infotm.com/
```

## system/libspeex/Config.in
```kconfig
config BR2_PACKAGE_LIBSPEEX
	bool "libspeex"
	select BR2_PACKAGE_LIBOGG
	help
	  Speex is an Open Source/Free Software patent-free
	  audio compression format designed for speech.
	  It can be used for Voice over IP

	  http://www.speex.org/

if BR2_PACKAGE_LIBSPEEX 
menu "options"
	config  BR2_PACKAGE_LIBSPEEX_INSTALL_SHARED
		bool "Install Shared"
		default y
		help
	  		install shared library into target dir	
endmenu

endif
```

## system/qlibcertif/Config.in
```kconfig
config BR2_PACKAGE_QLIBCERTIF
	bool "qlibcertif"
	default n
	help
	  algorithm certificate lib

	  http://www.infotm.com/
if BR2_PACKAGE_QLIBCERTIF
menu "options"
	config  BR2_PACKAGE_QLIBCERTIF_ENABLE_TEST
		bool "Install certif_test"
		default n
		help
	  		install certif_test into target dir	
endmenu

endif
```

## system/qlibcrypto/Config.in
```kconfig
config BR2_PACKAGE_QLIBCRYPTO
	bool "qlibcrypto"
	help
	  qcrypto lib

	  http://www.infotm.com/
```
