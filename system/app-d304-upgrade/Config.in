## system/app-d304-upgrade/Config.in
```kconfig
config BR2_PACKAGE_APP_D304_UPGRADE
	bool "D304 Upgrade"
	select BR2_PACKAGE_QLIBUPGRADE
	default n
	help
		Upgrade tool for QIWO304
```

## system/app-demos/Config.in
```kconfig
config BR2_PACKAGE_APP_DEMOS
    bool "app demos"
    default n
    help
        app demos
```

## system/app-ittd/Config.in
```kconfig
config BR2_PACKAGE_APP_ITTD
	bool "ITTD-Server"
	help
	  ITTD-Server
if BR2_PACKAGE_APP_ITTD
    config BR2_PACKAGE_APP_ITTD_V4L2_ONLY
        bool "Ittd tunning for V4L2"
        default n
        help
            Use Ittd connect to V4L2
endif
```

## system/app-ittd/old_version/Config.in
```kconfig
config BR2_PACKAGE_APP_ITTD
	bool "IQ Test device app"
	help
	  IQ Test device app
```

## system/app-launcher/Config.in
```kconfig
config BR2_PACKAGE_APP_LAUNCHER
	bool "launcher"
	help
	  launcher app

	  http://www.infotm.com/osa/

if BR2_PACKAGE_APP_LAUNCHER
choice
	prompt "Product select"
	default BR2_INFOTM_PRODUCT_DEFAULT
	help
	  Select the product to be used, which will affect the keys

config BR2_INFOTM_PRODUCT_DEFAULT
	bool "default"
	help
	  default product.

config BR2_INFOTM_PRODUCT_Q360
	bool "Q360"
	help
	  Q360 product.

config BR2_INFOTM_PRODUCT_LESHI_C23
	bool "leshi C23"
	help
	  Q360 product.
endchoice

config BR2_INFOTM_PRODUCT
	string
	default "default"     if BR2_INFOTM_PRODUCT_DEFAULT
	default "Q360"        if BR2_INFOTM_PRODUCT_Q360
	default "leshi C23"   if BR2_INFOTM_PRODUCT_LESHI_C23

menu "Options"
	config BR2_INFOTM_GUI_ENABLE
		bool "GUI needed"
		default n
		help
		  Board pattern: screen ui enabled

	config BR2_INFOTM_P2P_DANA_ENABLE
		bool "p2p dana needed"
		default n
		help
		  Board pattern: p2p dana enabled
	
	config BR2_INFOTM_BOARD_PATTERN
		string "Board pattern"
		default "cardv"
		help
		  Board pattern: cardv sportdv
	
	config BR2_INFOTM_CAMERA_REAR_ENABLE
		bool "Rear camera enable"
		default y
		help
		 Rear camera enable 
	
	config BR2_INFOTM_CAMERA_PIP_ENABLE
		bool "Rear camera pip enable"
		default y
		help
		 Rear camera pip enable 
	
	config BR2_INFOTM_LCD_ORIENTATION
		string "LCD orientation"
		default "landscape"
		help
		 LCD orientation: landscape portrait 

	config BR2_INFOTM_NETWORK_ENABLE
		bool "network enable"
		default y
		help
		 Network enable 
	
	config BR2_INFOTM_WIFI_ENABLE
		bool "Wifi enable"
		default n
		help
		 Wifi enable 
	
	config BR2_INFOTM_WIFI_MODEL
		string "Wifi model"
		default "bcm6212"
		help
		 Wifi model: bcm6212 rtl8189ES 
	
	config BR2_INFOTM_GPS_ENABLE
		bool "GPS enable"
		default y
		help
		 GPS enable 
	
	config BR2_INFOTM_RESOLUTION_SWITCH_MODULE
		string "Video resolution switch module"
		default "isp"
		help
		 Video resolution switch module, currently supported: postisp pp sensor isp 
	
	config BR2_INFOTM_VIDEO_WIFI_PREVIEW
		bool "Encoding another video stream for wifi apps"
		default "y"
		help
		 Encoding another video stream for wifi apps 
	
	config BR2_INFOTM_ADAS_ENABLE
		bool "ADAS enable"
		default y
		help
		 ADAS enable 
	
	config BR2_INFOTM_TIRED_ALARM
		bool "tired alarm enable"
		default n
		help
		 tired alarm enable
	
	config BR2_INFOTM_GUI_STYLE
		string "GUI style"
		default "large"
		help
		 GUI style: small large 
	
	config BR2_INFOTM_GUI_SHOW_STATUS_BAR
		bool "GUI show black status bar"
		default y
		help
		 GUI show black status bar 
	
	config BR2_INFOTM_GUI_AUTO_PLAY_ENABLE
		bool "GUI automatically play next video"
		default y
		help
		 GUI automatically play next video 
	
	config BR2_INFOTM_GUI_TIMER_RESET
		bool "GUI video loop recording time reset"
		default y
		help
		 GUI video loop recording time reset 
	
	config BR2_INFOTM_GUI_DEBUG_ENABLE
		bool "GUI debug info"
		default y
		help
		 GUI debug info 
	
	config BR2_INFOTM_EVENT_HTTP_ENABLE
		bool "GUI event http support"
		default n
		help
		 GUI event http support 

	config BR2_INFOTM_PLAYBACK_ENABLE
		bool "GUI playback support"
		default n
		help
		 GUI playback support 

	config BR2_INFOTM_SOUND_OUTPUT
		string "Sound output device"
		default "speaker"
		help
		  Sound output device: speaker or buzzer
	
	config BR2_INFOTM_Q360_UPGRADE_ENABLE
		bool "Q360 upgrade support"
		default n
		help
		 Q360 upgrade support 

	config BR2_INFOTM_MARKER_ENABLE
		bool "marker enable"
		default y
		help
		  Enable marker

	config BR2_INFOTM_PREVIEW_SECOND_WAY
		bool "wifi preview encode the second stream"
		default y
		help
		  Enable wifi preivew second stream

	config BR2_INFOTM_UVC_ENABLE
		bool "uvc enable"
		default n
		help
		  Enable uvc function

	config BR2_INFOTM_DOUBLE_CLICK_ENABLE
		bool "enable double click for keys"
		default n
		help
		  Enable double click
	config BR2_INFOTM_FULL_RESOLUTION_PHOTO_ENABLE
		bool "enable full resolution photo"
		default n
		help
		  Enable full resolution photo
	config BR2_INFOTM_DEFAULT_MODE_PHOTO
		bool "set default mode to photo mode"
		default n
		help
		  set default mode to photo mode


endmenu
endif
```

## system/app-libra-dana/Config.in
```kconfig
config BR2_PACKAGE_APP_LIBRA_DANA
	bool "app-libra-dana"
	help
	  app-libra-dana

	  http://www.infotm.com/

if BR2_PACKAGE_APP_LIBRA_DANA
menu "options"
	config  BR2_PACKAGE_APP_LIBRA_DANA_INSTALL_SHARED
		bool "Install Shared"
		default y
		help
	  		install shared library into target dir
endmenu

endif
```

## system/app-libra-main/Config.in
```kconfig
config BR2_PACKAGE_APP_LIBRA_MAIN
	bool "libra main"
	help
	  Osa communication lib

	  http://www.infotm.com/osa/

if BR2_PACKAGE_APP_LIBRA_MAIN
menu "Options"
	config BR2_INFOTM_BOARD_PATTERN
		string "Board pattern"
		default "cardv"
		help
		  Board pattern: cardv sportdv
	
	config BR2_INFOTM_CAMERA_REAR_ENABLE
		bool "Rear camera enable"
		default y
		help
		 Rear camera enable 
	
	config BR2_INFOTM_CAMERA_PIP_ENABLE
		bool "Rear camera pip enable"
		default y
		help
		 Rear camera pip enable 
	
	config BR2_INFOTM_LCD_ORIENTATION
		string "LCD orientation"
		default "landscape"
		help
		 LCD orientation: landscape portrait 
	
	config BR2_INFOTM_WIFI_ENABLE
		bool "Wifi enable"
		default n
		help
		 Wifi enable 
	
	config BR2_INFOTM_WIFI_MODEL
		string "Wifi model"
		default "bcm6212"
		help
		 Wifi model: bcm6212 rtl8189ES 
	
	config BR2_INFOTM_GPS_ENABLE
		bool "GPS enable"
		default y
		help
		 GPS enable 
	
	config BR2_INFOTM_RESOLUTION_SWITCH_MODULE
		string "Video resolution switch module"
		default "isp"
		help
		 Video resolution switch module, currently supported: postisp pp sensor isp 
	
	config BR2_INFOTM_VIDEO_WIFI_PREVIEW
		bool "Encoding another video stream for wifi apps"
		default "y"
		help
		 Encoding another video stream for wifi apps 
	
	config BR2_INFOTM_ADAS_ENABLE
		bool "ADAS enable"
		default y
		help
		 ADAS enable 
	
	config BR2_INFOTM_GUI_STYLE
		string "GUI style"
		default "large"
		help
		 GUI style: small large 
	
	config BR2_INFOTM_GUI_SHOW_STATUS_BAR
		bool "GUI show black status bar"
		default y
		help
		 GUI show black status bar 
	
	config BR2_INFOTM_GUI_AUTO_PLAY_ENABLE
		bool "GUI automatically play next video"
		default y
		help
		 GUI automatically play next video 
	
	config BR2_INFOTM_GUI_TIMER_RESET
		bool "GUI video loop recording time reset"
		default y
		help
		 GUI video loop recording time reset 
	
	config BR2_INFOTM_GUI_DEBUG_ENABLE
		bool "GUI debug info"
		default y
		help
		 GUI debug info 
	
	config BR2_INFOTM_EVENT_HTTP_ENABLE
		bool "GUI event http support"
		default n
		help
		 GUI event http support 
	
endmenu
endif
```

## system/app-specs-bt/Config.in
```kconfig
config BR2_PACKAGE_APP_SPECS_BT
	bool "app-specs-bt"
	help
	  app-specs-main app 

	  http://www.infotm.com/
```

## system/app-vrec/Config.in
```kconfig
config BR2_PACKAGE_APP_REC_DEMO
    bool "video recoder demo"
    help
        recoder demo,using the demo CMakeList to construct your static app.
```

## system/audiobox/Config.in
```kconfig
config BR2_PACKAGE_AUDIOBOX
	bool "Audiobox"
	default y
	select BR2_PACKAGE_ALSA_LIB
	select BR2_PACKAGE_HLIBVCP7G
	help
	  Audiobox deal with QSDK audio issues

if BR2_PACKAGE_AUDIOBOX
    menu "boot speed config"
        config BR2_PACKAGE_AUDIOBOX_OPTIMIZATION
        bool "Optimize audiobox boot speed"
        default n
        help
            Optimize audiobox's speed by method staticfy its dependency library.when selected, complier will use
            static lib as possible, and if only dynamic lib exits, complier will use dynamic lib.
    endmenu
endif
```

## system/audiobox2/Config.in
```kconfig
config BR2_PACKAGE_AUDIOBOX2
	bool "Audiobox2(developing)"
	default n
	select BR2_PACKAGE_ALSA_LIB
	select BR2_PACKAGE_HLIBVCP7G
	help
	  Audiobox2 deal with QSDK audio issues
```

## system/bblite/Config.in
```kconfig
config BR2_PACKAGE_BBLITE
	bool "BusyBox Lite"
	default y
	help
		This is the busybox for ramdisk

if BR2_PACKAGE_BBLITE

config BR2_PACKAGE_BBLITE_CONFIG
	string "BusyBox configuration file to use?"
	default "buildroot/package/busybox/busybox-1.21.x.config"
	help
	  Some people may wish to use their own modified BusyBox configuration
	  file, and will specify their config file location with this option.

	  Most people will just use the default BusyBox configuration file.

endif
```

## system/cep/Config.in
```kconfig
config BR2_PACKAGE_CEP
	bool "common event provider"
	help
	  all event realized
```

## system/eventhub/Config.in
```kconfig
config BR2_PACKAGE_EVENTHUB
	bool "eventhub"
	help

	  http://www.infotm.com/


config BR2_PACKAGE_TESTING_EVENT
	bool "event testing"
	depends on BR2_PACKAGE_EVENTHUB
	help

	  http://www.infotm.com/
```

## system/fisheye_k_tool/Config.in
```kconfig
config BR2_PACKAGE_FISHEYE_K_TOOL
	bool "Fisheye Calibration Tool"
    default n
    select  BR2_PACKAGE_LIBGRIDTOOLS
	help
		Fisheye Calibration Tool

if BR2_PACKAGE_FISHEYE_K_TOOL


endif
```

## system/hlibcamsensor/Config.in
```kconfig
config BR2_PACKAGE_HLIBCAMSENSOR
	
	bool "hlibcamsensor"
    default y
    help
	    camera sensor hardware abstraction layer. 
if BR2_PACKAGE_HLIBCAMSENSOR
menu "select build source codes types"
	config BUILD_ALL_CAMERA_SENSORS
	tristate "BUILD_ALL_SENSORS"
    default y
    help
        choice build all camera sensor source codes.
if [ $BUILD_ALL_CAMERA_SENSORS != 'y' ]
    config BUILD_SELECTED_SENSOR
    bool "BUILD_SELECTED_SENSOR" 
    if [ $BUILD_SELECTED_SENSOR = 'y' ]
    menu "all sensor list"
        config IIFDG
        bool "IIFDG"
        config AR330_DVP
        bool "AR330_DVP"
        config AR330_MIPI
        bool "AR330_MIPI"
        config IMX322_DVP
        bool "IMX322_DVP"
        config IMX179_MIPI
        bool "IMX179_MIPI"
        config OV683_MIPI
        bool "OV683_MIPI"
        config OV2710_MIPI
        bool "OV2710_MIPI"
        config OV4689
        bool "OV4689"
        config OV4688
        bool "OV4688"
        config P401
        bool "P401"
        config SC2135_DVP
        bool "SC2135_DVP"
        config SC2235_DVP
        bool "SC2235_DVP"
        config SC1135_DVP
        bool "SC1135_DVP"
        config SC3035_DVP
        bool "SC3035_DVP"
        config STK3855_DVP
        bool "STK3855_DVP"
        config DUAL_BRIDGE
        bool "DUAL_BRIDGE"
        config XC9080_MIPI
        bool "XC9080_MIPI"
    endmenu
    endif
endif
endmenu

menu "select bridge sensors"
	config BUILD_ALL_BRIDGE_SENSORS
	tristate "BUILD_ALL_BRIDGE_SENSORS"
		default y
	help
		choice build all bridge sensors

	if [ $BUILD_ALL_BRIDGE_SENSORS != 'y' ]
		config BUILD_SELECTED_BRIDGE_SENSOR
		bool "BUILD_SELECTED_BRIDGE_SENSOR"
		if [ $BUILD_SELECTED_BRIDGE_SENSOR = 'y' ]
			menu "all bridge sensors list"
				config AR330_DUAL_DVP
					bool "AR330_DUAL_DVP"
				config NT99142_DUAL_DVP
					bool "NT99142_DUAL_DVP"
				config SC3035_DUAL_DVP
					bool "SC3035_DUAL_DVP"
				config HM2131_DUAL_MIPI
					bool "HM2131_DUAL_MIPI"
				config OV4689_DUAL_MIPI
					bool "OV4689_DUAL_MIPI"
				config H65_DUAL_MIPI
					bool "H65_DUAL_MIPI"
				config K02_DUAL_MIPI
					bool "K02_DUAL_MIPI"
				config IMX291_DUAL_DVP
					bool "IMX291_DUAL_DVP"
			endmenu
		endif
	endif
endmenu

menu "select bridge"
	config BUILD_ALL_BRIDGE
	tristate "BUILD_ALL_BRIDGE"
		default y
	help
		choice build all bridge

	if [ $BUILD_ALL_BRIDGE != 'y' ]
		config BUILD_SELECTED_BRIDGE
		bool "BUILD_SELECTED_BRIDGE"
		if [ $BUILD_SELECTED_BRIDGE = 'y' ]
			menu "all bridge  list"
				config BRIDGE_SX2_DVP
					bool "BRIDGE_SX2_DVP"
				config BRIDGE_XC9080_MIPI
					bool "BRIDGE_XC9080_MIPI"
				config BRIDGE_OV683_MIPI
					bool "BRIDGE_OV683_MIPI"
				config BRIDGE_STK3855_DVP
					bool "BRIDGE_STK3855_DVP"
			endmenu
		endif
	endif
endmenu

endif
```

## system/hlibdsp/Config.in
```kconfig
config BR2_PACKAGE_HLIBDSP
	bool "hlibdsp"
	default n
	help 
	  InfoTM dsp lib.

if BR2_PACKAGE_HLIBDSP

menu "options"

	choice
		prompt "DSP Type"
		default BR2_PACKAGE_HLIBDSP_CEVA_TL421
		help
		  CEVA TL421 dsp.

	config BR2_PACKAGE_HLIBDSP_CEVA_TL421
		bool "ceva-tl421"
		help
		  CEVA TL421 dsp.
	endchoice

	choice
		prompt "DDR Size"
		default BR2_PACKAGE_HLIBDSP_DDR_64MB
		help
		  Select the DDR size your system using.

	config BR2_PACKAGE_HLIBDSP_DDR_64MB
		bool "64MB"
		help
		  DDR size of system is 64MB.

	config BR2_PACKAGE_HLIBDSP_DDR_128MB
		bool "128MB"
		help
		  DDR size of system is 128MB.
	endchoice

    choice
        prompt "DSP Algorithm"
        default BR2_PACKAGE_HLIBDSP_AEC
        default n
        help
            Select dsp Algorithm on platform

    config BR2_PACKAGE_HLIBDSP_AAC_ENCODE
        bool "dsp AAC encode"
        default n
        help
            Apply AAC Encode algorithm on dsp

    config BR2_PACKAGE_HLIBDSP_AAC_DECODE
        bool "dsp AAC decode(under develop;not recommand)"
        default n
        help
            Apply AAC Decode algorithm on dsp

    config BR2_PACKAGE_HLIBDSP_AEC
        bool "dsp AEC"
        default n
        help
            Apply dsp AEC algorithm on dsp
	endchoice

    choice
        prompt "AEC Algorithm version choose"
        depends on BR2_PACKAGE_HLIBDSP_AEC
        default BR2_PACKAGE_HLIBDSP_AECV1
        help
            Select AEC Algorithm version on platform

    config BR2_PACKAGE_HLIBDSP_AECV1
        bool "AEC Algorithm version 1"
        default n
        help
            Apply AEC Algorithm version1 on platform

    config BR2_PACKAGE_HLIBDSP_AECV2
        bool "AEC Algorithm version 2"
        default n
        help
            Apply AEC Algorithm version2 on platform

    endchoice

endmenu

endif
```

## system/hlibfodetv2/Config.in
```kconfig
config BR2_PACKAGE_HLIBFODETV2
	bool "hlibfodetv2"
        default n
	help
	  Fix me

	  http://www.infotm.com/
```

## system/hlibfr/Config.in
```kconfig
config BR2_PACKAGE_HLIBFR
	bool "hlibfr"
	help 
	  fr(frame-ring) enable you to access /dev/fring to allocate
	  and free memory as ring buffer.

choice 
	bool "cache policy for fr buffer"
	default BR2_FR_CC_BUFFER
	depends on BR2_PACKAGE_HLIBFR
	
config BR2_FR_CC_BUFFER
	bool "FR CACHE BUFFER"
	help
	    fr mmap to buffer (no cache).

config BR2_FR_CC_WRITETHROUGH
	bool "FR CACHE WRITETHROUGH"
	help
	    fr mmap to cache writethrough.

config BR2_FR_CC_WRITEBACK
	bool "FR CACHE WRITEBACK"
	help
	    fr mmap to cache writeback.


endchoice
	
choice
        bool "mmap scheme for fr buffer"
        default BR2_FR_MMAP_EACH_ONE
        depends on BR2_PACKAGE_HLIBFR

config BR2_FR_MMAP_EACH_ONE
        bool "FR MMAP Every ONE"
        help
            fr mmap to buffer all time

config BR2_FR_MMAP_ONLY_ONE
        bool "FR MMAP Only at First"
        help
            fr mmap to buffer only at first time

endchoice
```

## system/hlibg1v6/Config.in
```kconfig
config BR2_PACKAGE_HLIBG1V6
	bool "libg1v6"

	help
		libg1v6 library
		http://www.infotm.com/

if BR2_PACKAGE_HLIBG1V6 
menu "options"
	config  BR2_PACKAGE_HLIBG1V6_INSTALL_SHARED
		bool "Install Shared"
		default y
		help
	  		install shared library into target dir	
endmenu

endif
```
