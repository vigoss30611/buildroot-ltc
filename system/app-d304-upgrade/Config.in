## system/hlibg2v1/Config.in
```kconfig
config BR2_PACKAGE_HLIBG2V1
	bool "libhw_vdec_g2"

	help
		hlibg2v1 library
		http://www.infotm.com/

if BR2_PACKAGE_HLIBG2V1 
menu "options"
	config  BR2_PACKAGE_HLIBG2V1_INSTALL_SHARED
		bool "Install Shared"
		default y
		help
	  		install shared library into target dir	
endmenu

endif
```

## system/hlibguvc/Config.in
```kconfig
config BR2_PACKAGE_HLIBGUVC
	bool "hlibguvc"
	help 
	  guvc(gadget uvc) device-side uvc library
```

## system/hlibh1v6/Config.in
```kconfig
config BR2_PACKAGE_HLIBH1V6
	bool "libh1v6"

	help
		libh1v6 library
		http://www.infotm.com/

if BR2_PACKAGE_HLIBH1V6
menu "Options"
	config  BR2_PACKAGE_HLIBH1V6_GDBDEBUG
		bool "h1 gdb debug"
		default n
		help
	  		gdb debug support
	config  BR2_PACKAGE_HLIBH1V6_TESTBENCH
		bool "h1 testbench"
		default n
		help
	  		enable h2v6 testbench, 264 and jpeg
	config  BR2_PACKAGE_HLIBH1V6_POLL
		bool "h1 ewl polling mode"
		default n
		help
	  		enable h1 ewl poll mode
endmenu

endif
```

## system/hlibh2v1/Config.in
```kconfig
config BR2_PACKAGE_HLIBH2V1
	bool "libh2v1"

	help
		libh2v1, do not select me directly ,will auto select by videobox
		http://www.infotm.com/

if BR2_PACKAGE_HLIBH2V1
menu "Options"
	config  BR2_PACKAGE_HLIBH2V1_GDBDEBUG
		bool "h2 gdb debug"
		default n
		help
	  		gdb debug support
	config  BR2_PACKAGE_HLIBH2V1_TESTBENCH
		bool "h2 testbench"
		default n
		help
	  		enable h2v4 testbench
	config  BR2_PACKAGE_HLIBH2V1_POLL
		bool "h2 ewl polling mode"
		default n
		help
	  		enable h2 ewl poll mode
endmenu
endif
```
